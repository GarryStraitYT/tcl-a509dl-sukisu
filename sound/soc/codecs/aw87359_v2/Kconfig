## sound/soc/codecs/aw87359_v2/Kconfig
```kconfig
config SND_SOC_AW87935_V2
	tristate "SoC Audio for awinic AW87XXX Smart K PA"
	depends on I2C
	help
	  This option enables support for AW87XXX Smart K PA.
```

## sound/soc/codecs/aw87xxx_model_3/Kconfig
```kconfig
config SND_SOC_AW87XXX_MODEL_3
	tristate "SoC Audio for awinic AW87XXX Smart K PA with model_3"
	depends on I2C
	help
	  This option enables support for AW87XXX Smart K PA with model_3.
```

## sound/soc/codecs/aw87xxx_v2/Kconfig
```kconfig
config SND_SOC_AW87XXX_V2
	tristate "SoC Audio for awinic AW87XXX Smart K PA"
	depends on I2C
	help
	  This option enables support for AW87XXX Smart K PA.

config SND_SOC_AW87XXX_CRUZE_V2
	tristate "SoC Audio for awinic AW87XXX for cruze family"
	depends on I2C
	help
	  This option enables support for AW87XXX for cruze family.
```

## sound/soc/codecs/cruzepro_aw87359/Kconfig
```kconfig
config SND_SOC_AW87XXX_CRUZE
	tristate "SoC Audio for awinic AW87XXX Smart K PA"
	depends on I2C
	help
	  This option enables support for AW87XXX Smart K PA.
```
