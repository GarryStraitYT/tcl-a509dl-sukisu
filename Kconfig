## arch/arm64/configs/vali5gtmo_debug_defconfig
```kconfig
# CONFIG_LOCALVERSION_AUTO is not set
CONFIG_PREEMPT=y
CONFIG_IKHEADERS=m
CONFIG_LOG_BUF_SHIFT=22
CONFIG_UCLAMP_TASK=y
CONFIG_BLK_CGROUP=y
CONFIG_UCLAMP_TASK_GROUP=y
CONFIG_CPUSETS=y
CONFIG_CGROUP_DEBUG=y
CONFIG_SCHED_TUNE=y
CONFIG_SYSCTL_SYSCALL=y
# CONFIG_FHANDLE is not set
#remove CONFIG_KALLSYMS_ALL and CONFIG_KPROBES by ying.pang for CHLRTMO-9772
#CONFIG_KALLSYMS_ALL=y
# CONFIG_KALLSYMS_BASE_RELATIVE is not set
CONFIG_MTK_SCHED_EXTENSION=y
CONFIG_MTK_IDLE_BALANCE_ENHANCEMENT=y
CONFIG_MTK_SCHED_INTEROP=y
CONFIG_MTK_SCHED_LB_ENHANCEMENT=y
CONFIG_MTK_SCHED_TRACERS=y
CONFIG_MTK_SCHED_CPU_PREFER=y
CONFIG_MTK_SCHED_BIG_TASK_MIGRATE=y
CONFIG_ARCH_MEDIATEK=y
CONFIG_MACH_MT6833=y
CONFIG_SCHED_MC=y
CONFIG_NR_CPUS=8
CONFIG_ARM64_DMA_USE_IOMMU=y
CONFIG_RANDOMIZE_BASE=y
CONFIG_CMDLINE="console=tty0 console=ttyMT3,921600n1 root=/dev/ram vmalloc=496M slub_max_order=0 slub_debug=O "
# CONFIG_EFI is not set
CONFIG_PM_DEBUG=y
CONFIG_DPM_WATCHDOG=y
CONFIG_DPM_WATCHDOG_TIMEOUT=10
CONFIG_WQ_POWER_EFFICIENT_DEFAULT=y
CONFIG_ENERGY_MODEL=y
CONFIG_CPU_FREQ=y
CONFIG_CPU_FREQ_STAT=y
CONFIG_CPU_FREQ_DEFAULT_GOV_SCHEDUTIL=y
CONFIG_CPU_FREQ_GOV_POWERSAVE=y
CONFIG_CPU_FREQ_GOV_USERSPACE=y
CONFIG_CPU_FREQ_GOV_ONDEMAND=y
CONFIG_KPROBES=y
CONFIG_LTO_CLANG=y
CONFIG_CFI_CLANG=y
CONFIG_MODULE_SRCVERSION_ALL=y
# CONFIG_BLK_DEV_BSG is not set
CONFIG_BLK_INLINE_ENCRYPTION=y
CONFIG_BLK_INLINE_ENCRYPTION_FALLBACK=y
# CONFIG_CORE_DUMP_DEFAULT_ELF_HEADERS is not set
CONFIG_ZSMALLOC=y
CONFIG_XFRM_MIGRATE=y
CONFIG_SYN_COOKIES=y
CONFIG_VLAN_8021Q=y
CONFIG_CLS_U32_PERF=y
CONFIG_CLS_U32_MARK=y
CONFIG_CFG80211=y
CONFIG_NL80211_TESTMODE=y
CONFIG_CFG80211_DEVELOPER_WARNINGS=y
# CONFIG_CFG80211_DEFAULT_PS is not set
CONFIG_CFG80211_DEBUGFS=y
# CONFIG_UEVENT_HELPER is not set
CONFIG_EXTRA_FIRMWARE="valhall-1691526.wa"
CONFIG_EXTRA_FIRMWARE_DIR="firmware"
# CONFIG_FW_CACHE is not set
CONFIG_MTD=y
CONFIG_MTD_BLOCK=y
CONFIG_ZRAM=y
CONFIG_BLK_DEV_LOOP_MIN_COUNT=40
CONFIG_ANDROID_DEFAULT_SETTING=y
CONFIG_MTK_ANDROID_DEFAULT_SETTING=y
CONFIG_USB_MTK_HDRC=y
CONFIG_MTK_MUSB_QMU_SUPPORT=y
CONFIG_MTK_MUSB_QMU_PURE_ZLP_SUPPORT=y
CONFIG_MTK_MUSB_DRV_36BIT=y
CONFIG_USB_MTK_OTG=y
CONFIG_MTK_MUSB_DUAL_ROLE=y
CONFIG_TYPEC=y
CONFIG_MTK_PLATFORM="mt6853"
CONFIG_ARCH_MTK_PROJECT="vali5gtmo"
CONFIG_MTK_ENG_BUILD=y
# CONFIG_MTK_BLOCK_TAG is not set
CONFIG_MTK_PTPOD=y
CONFIG_MTK_STATIC_POWER=y
CONFIG_MTK_UNIFY_POWER=y
CONFIG_MTK_CPU_FREQ=y
CONFIG_MTK_PTPOD_GPU=y
CONFIG_MTK_PBM=y
CONFIG_MTK_PMIC_NEW_ARCH=y
CONFIG_MTK_PMIC_COMMON=y
CONFIG_MTK_PMIC_CHIP_MT6359P=y
CONFIG_MTK_EXTERNAL_CHARGER_TYPE_DETECT=y
CONFIG_MFD_MT6360_PMU=y
CONFIG_MT6360_PMU_CHARGER=y
CONFIG_CHARGER_BQ25601_SLAVE=y
CONFIG_CHARGER_SGM41513_SLAVE=y
CONFIG_MTK_PUMP_EXPRESS_PLUS_20_SUPPORT=y
CONFIG_MTK_DUAL_CHARGER_SUPPORT=y
CONFIG_TCT_CHARGER=y
CONFIG_MT6360_PMU_FLED=y
CONFIG_MT6360_PMIC=y
CONFIG_MT6360_LDO=y

#Begin ersen.shang for SOCAOSP13-6985 EncoreTF Camera BringUp 2022-06
CONFIG_CUSTOM_KERNEL_IMGSENSOR="tsppsnp1269_s5kjn1_mipi_raw tspphcp1367_hi1336_mipi_raw tspphcp2120_hi1336_mipi_raw shncnd42b_s5k3l6_mipi_raw shnbf821b_gc08a3_mipi_raw tsps8f9074_s5k4h7_mipi_raw cxtvc12499_gc02m1b_mipi_mono cxtvc12851_gc02m1b_mipi_mono shnbf204c_gc02m1_mipi_raw cxtvc12852_gc02m1_mipi_raw"
#End   ersen.shang for SOCAOSP13-6985 EncoreTF Camera BringUp 2022-06

CONFIG_CUSTOM_KERNEL_LCM="nt35695B_fhd_dsi_cmd_auo_rt5081 td4330_fhdp_dsi_cmd_auo_rt5081 ft8756_fhdp_dsi_vdo_auo_rt4801"
CONFIG_CUSTOM_KERNEL_LCM="panel-buffalo-gc7202-dsi-vdo-tft"
CONFIG_MTK_SYNC=y
CONFIG_MTK_LCM_PHYSICAL_ROTATION="0"
CONFIG_LCM_HEIGHT="1612"
CONFIG_LCM_WIDTH="720"
CONFIG_MTK_AAL_SUPPORT=y
CONFIG_MTK_PSEUDO_M4U=y
CONFIG_MTK_FLASHLIGHT=y
CONFIG_MTK_FLASHLIGHT_MT6360=y
#CONFIG_MTK_FLASHLIGHT_PT=y
CONFIG_MTK_FLASHLIGHT_PT_STRICT=y
CONFIG_MTK_FLASHLIGHT_DLPT=y
CONFIG_MTK_IMGSENSOR=y
CONFIG_MTK_LENS=y
CONFIG_MTK_CAM_CAL=y
CONFIG_MTK_CMDQ=y
CONFIG_MTK_CMDQ_MBOX_EXT=y
CONFIG_MTK_SMI_EXT=y
CONFIG_MTK_CCU=y
CONFIG_MTK_CAM_SECURITY_SUPPORT=y
CONFIG_MTK_CAM_GENIEZONE_SUPPORT=y
CONFIG_MTK_SENSOR_SUPPORT=y
CONFIG_MTK_SENSOR_ARCHITECTURE="2.0"
CONFIG_CUSTOM_KERNEL_ACCELEROMETER=y
CONFIG_CUSTOM_KERNEL_ALSPS=y
#Begin Modified by yan.gong for FR 10941246 on 2021-04-28
CONFIG_CUSTOM_KERNEL_GYROSCOPE=y
CONFIG_CUSTOM_KERNEL_MAGNETOMETER=y
CONFIG_CUSTOM_KERNEL_BAROMETER=y
CONFIG_CUSTOM_KERNEL_SENSORHUB=y
CONFIG_NANOHUB=y
CONFIG_NANOHUB_MTK_IPI=y
# CONFIG_CUSTOM_KERNEL_GRV_SENSOR is not set
# CONFIG_CUSTOM_KERNEL_GMRV_SENSOR is not set
# CONFIG_CUSTOM_KERNEL_RV_SENSOR is not set
# CONFIG_CUSTOM_KERNEL_LINEARACCEL_SENSOR is not set
# CONFIG_CUSTOM_KERNEL_GRAVITY_SENSOR is not set
# CONFIG_CUSTOM_KERNEL_UNCALI_ACC_SENSOR is not set
# CONFIG_CUSTOM_KERNEL_UNCALI_GYRO_SENSOR is not set
# CONFIG_CUSTOM_KERNEL_UNCALI_MAG_SENSOR is not set
# CONFIG_CUSTOM_KERNEL_STEP_COUNTER is not set
#End Modified by yan.gong for FR 10941246 on 2021-04-28
CONFIG_MTK_CCCI_DEVICES=y
CONFIG_MTK_MD1_SUPPORT=25
CONFIG_MTK_ECCCI_DRIVER=y
CONFIG_MTK_ECCCI_C2K=y
CONFIG_MTK_BTIF=y
CONFIG_MTK_COMBO=y
CONFIG_MTK_COMBO_CHIP_CONSYS_6833=y
CONFIG_MTK_COMBO_GPS=y
CONFIG_MTK_COMBO_WIFI=y
CONFIG_MTK_DHCPV6C_WIFI=y
CONFIG_MTK_GPS_SUPPORT=y
CONFIG_MTK_GPS_EMI=y
CONFIG_MTK_FMRADIO=y
CONFIG_MTK_FM_CHIP="MT6631_FM"
CONFIG_MTK_CONNSYS_DEDICATED_LOG_PATH=y
CONFIG_MTK_MDDP_SUPPORT=y
CONFIG_HAVE_MTK_ENABLE_GENIEZONE=y
CONFIG_MTK_ENABLE_GENIEZONE=y
CONFIG_MTK_GZ_MAIN=y
CONFIG_MTK_GZ_LOG=y
CONFIG_MTK_GZ_VIRTIO=y
CONFIG_MTK_GZ_VIRTIO_IPC=y
CONFIG_MTK_GZ_IRQ=y
CONFIG_HAVE_MTK_GZ_LOG=y
CONFIG_EXTCON_MTK_USB=y
CONFIG_MTK_USB_TYPEC_U3_MUX=y
CONFIG_TCPC_CLASS=y
CONFIG_TCPC_MT6360=y
CONFIG_USB_POWER_DELIVERY=y
CONFIG_MTK_LEDS=y
CONFIG_LEDS_MTK_PWM=y
CONFIG_MTK_PWM=y
CONFIG_MTK_ACCDET=y
CONFIG_ACCDET_EINT_IRQ=y
CONFIG_ACCDET_SUPPORT_EINT0=y
CONFIG_MTK_RTC=y
CONFIG_MTK_PERF_COMMON=y
CONFIG_MTK_PERF_TRACKER=y
CONFIG_MTK_LOAD_TRACKER=y
CONFIG_MTK_CPU_CTRL_CFP=y
CONFIG_MTK_PERF_OBSERVER=y
CONFIG_MTK_RESYM=y
CONFIG_MTK_FPSGO_V3=y
CONFIG_MTK_GBE=y
CONFIG_MTK_TASK_TURBO=y
CONFIG_MTK_TINYSYS_SCP_SUPPORT=y
CONFIG_MTK_TINYSYS_SSPM_SUPPORT=y
CONFIG_MTK_TINYSYS_SSPM_V2=y

CONFIG_MTK_MET_PLF=m
CONFIG_MTPROF=y
CONFIG_MTK_SCHED_MONITOR=y
CONFIG_MTK_IRQ_COUNT_TRACER=y
CONFIG_MTK_IRQ_OFF_TRACER=y
CONFIG_MTK_PREEMPT_TRACER=y
CONFIG_MTK_AEE_UT=y
CONFIG_MTK_AEE_HANGDET=y
CONFIG_MTK_CM_MGR_LEGACY=y
CONFIG_MTK_VIBRATOR=y
CONFIG_MTK_LEGACY_THERMAL=y
CONFIG_MTK_THERMAL_PA_VIA_ATCMD=y
CONFIG_MTK_CAMERA_ISP_RSC_SUPPORT=y
CONFIG_MTK_CAMERA_ISP_DPE_SUPPORT=y
CONFIG_MTK_CAMERA_ISP_MFB_SUPPORT=y
CONFIG_MTK_CAMERA_ISP_FD_SUPPORT=y
CONFIG_MTK_TINYSYS_MCUPM_SUPPORT=y
CONFIG_MTK_DRAM_LOG_STORE=y
CONFIG_MTK_DRAM_LOG_STORE_ADDR=0x0011DF00
CONFIG_MTK_DRAM_LOG_STORE_SIZE=0x100
#remove CONFIG_MTK_VOW_SUPPORT by ying.pang for CHLRTMO-9772 project not support VOW begin
#CONFIG_MTK_VOW_SUPPORT=y
#CONFIG_MTK_VOW_DUAL_MIC_SUPPORT=y
#CONFIG_MTK_VOW_MAX_PDK_NUMBER=1
#CONFIG_MTK_VOW_DSP_VERSION="ver02"
#remove CONFIG_MTK_VOW_SUPPORT by ying.pang for CHLRTMO-9772 project not support VOW end
CONFIG_MTK_FREQ_HOPPING=y
CONFIG_SCSI=y
CONFIG_BLK_DEV_SD=y
CONFIG_SCSI_SCAN_ASYNC=y
CONFIG_SCSI_UFSHCD=y
CONFIG_SCSI_UFSHCD_PLATFORM=y
CONFIG_SCSI_UFS_MEDIATEK=y
CONFIG_SCSI_UFS_FEATURE=y
#CONFIG_SCSI_UFS_HPB=y #[TCT-SPD][PERF]jimeng.zhang closed for more ram, useless for ufs under 3.1,CHLRTMO-10147
CONFIG_SCSI_UFS_TW=y
#CONFIG_SCSI_SKHPB=y #[TCT-SPD][PERF]jimeng.zhang closed for more ram, useless for ufs under 3.1,CHLRTMO-10147
CONFIG_SCSI_UFS_CRYPTO=y
CONFIG_DM_DEBUG=y
CONFIG_DM_CRYPT=y
CONFIG_DM_DEFAULT_KEY=y
CONFIG_DM_UEVENT=y
CONFIG_DM_VERITY_FEC=y
CONFIG_IFB=y
# CONFIG_ETHERNET is not set
CONFIG_PPP_FILTER=y
CONFIG_PPP_MULTILINK=y
CONFIG_PPPOE=y
CONFIG_PPP_ASYNC=y
CONFIG_PPP_SYNC_TTY=y
CONFIG_USB_USBNET=y
CONFIG_KEYBOARD_MTK_PMIC=y
CONFIG_KEYBOARD_MTK=y
CONFIG_ONEKEY_REBOOT_NORMAL_MODE=y
CONFIG_ONEKEY_REBOOT_OTHER_MODE=y
CONFIG_KPD_PWRKEY_USE_PMIC=y
# CONFIG_INPUT_MOUSE is not set

#Begin jiaxin.pi add
CONFIG_INPUT_TOUCHSCREEN=y
#CONFIG_TOUCHSCREEN_MTK_TOUCH="galaxycore_gc7202"
CONFIG_TOUCHSCREEN_MTK=y
CONFIG_BUFFALOTMO_GC7202_TOUCH=y
#CONFIG_TOUCHSCREEN_BUFFALO_FT8756=y
#CONFIG_DRM_PANEL_BUFFALO_GC7202_TFT=y
#End jiaxin.pi add

#Begin add by bing-zhang for ENCORETF-2 on 2022/06/07
CONFIG_DRM_PANEL_ENCORE_NL9916_TRULY_TRULY_HDPLUS1612_DSI_VDO=y
CONFIG_TOUCHSCREEN_ENCORE_NL9916_HDPLUS1612_SPI=y
#End add by bing-zhang for ENCORETF-2 on 2022/06/07

#Begin add by bing-zhang for ENCORETF-7457 on 2022/10/13
CONFIG_DRM_PANEL_ENCORE_FT8057_INX_TDT_HDPLUS1612_DSI_VDO=y
CONFIG_TOUCHSCREEN_ENCORE_FT8057_HDPLUS1612_SPI=y
#End add by bing-zhang for ENCORETF-7457 on 2022/10/13

CONFIG_INPUT_MISC=y
CONFIG_INPUT_UINPUT=y
# CONFIG_VT is not set
CONFIG_LEGACY_PTY_COUNT=16
# CONFIG_DEVMEM is not set
CONFIG_SERIAL_8250=y
CONFIG_SERIAL_8250_CONSOLE=y
CONFIG_SERIAL_8250_NR_UARTS=2
CONFIG_SERIAL_8250_RUNTIME_UARTS=2
CONFIG_SERIAL_8250_MT6577=y
CONFIG_I2C_MTK=y
CONFIG_SPI=y
CONFIG_SPI_MT65XX=y
CONFIG_SPMI=y
CONFIG_MTK_PMIF=y
CONFIG_MTK_CHARGER=y
CONFIG_MTK_KERNEL_POWER_OFF_CHARGING=y
CONFIG_MTK_GAUGE_VERSION=30
# CONFIG_HWMON is not set
CONFIG_THERMAL=y
CONFIG_THERMAL_DEFAULT_GOV_BACKWARD_COMPATIBLE=y
CONFIG_WATCHDOG=y
CONFIG_MEDIATEK_WATCHDOG=y
CONFIG_MFD_MT6358=y
CONFIG_MT6358_MISC=y
CONFIG_MTK_MFD_SPMI_PMIC=y
CONFIG_REGULATOR_MT6315=y
CONFIG_REGULATOR_MT6359P=y
CONFIG_MEDIA_SUPPORT=y
CONFIG_MEDIA_CAMERA_SUPPORT=y
CONFIG_VIDEO_V4L2_SUBDEV_API=y
CONFIG_V4L2_FLASH_LED_CLASS=y
CONFIG_V4L_PLATFORM_DRIVERS=y
CONFIG_V4L_MEM2MEM_DRIVERS=y
CONFIG_VIDEO_MEDIATEK_JPEG=y
CONFIG_VIDEO_MEDIATEK_VCODEC=y
CONFIG_DRM=y
#Begin jiaxin.pi add
CONFIG_DRM_PANEL_BUFFALO_FT8756_CSOT=y
# CONFIG_DRM_PANEL_NT35695B_AUO_VDO is not set
# CONFIG_DRM_PANEL_TRULY_TD4330_VDO is not set
# CONFIG_DRM_PANEL_TRULY_FT8756_VDO is not set
CONFIG_BIAS_TPS65132_I2C=y
CONFIG_DRM_MEDIATEK=y
#End jiaxin.pi add
CONFIG_MTK_GPU_SUPPORT=y
CONFIG_MTK_GPU_VERSION="mali valhall r32p1"
CONFIG_MTK_GPU_COMMON_DVFS_SUPPORT=y
CONFIG_FB_MODE_HELPERS=y
CONFIG_FB_TILEBLITTING=y
CONFIG_BACKLIGHT_LCD_SUPPORT=y
CONFIG_BACKLIGHT_CLASS_DEVICE=y
CONFIG_LOGO=y
CONFIG_SND_HRTIMER=y
CONFIG_SND_DYNAMIC_MINORS=y
CONFIG_SND_VERBOSE_PRINTK=y
CONFIG_SND_DEBUG=y
CONFIG_SND_DEBUG_VERBOSE=y
CONFIG_SND_PCM_XRUN_DEBUG=y
CONFIG_SND_SEQUENCER=y
CONFIG_SND_SEQ_DUMMY=y
CONFIG_SND_USB_AUDIO=y
CONFIG_SND_SOC=y
CONFIG_SND_SOC_MT6833_MT6359=y
CONFIG_SND_SOC_MTK_BTCVSD=y
#remove CONFIG_MTK_VOW_BARGE_IN_SUPPORT by ying.pang for CHLRTMO-9772 project not support VOW
#CONFIG_MTK_VOW_BARGE_IN_SUPPORT=y
#CONFIG_SND_SOC_RT5509=y
CONFIG_HIDRAW=y
CONFIG_HID_A4TECH=y
CONFIG_HID_APPLE=y
CONFIG_HID_BELKIN=y
CONFIG_HID_CHERRY=y
CONFIG_HID_CHICONY=y
CONFIG_HID_CYPRESS=y
CONFIG_HID_DRAGONRISE=y
CONFIG_HID_EZKEY=y
CONFIG_HID_KYE=y
CONFIG_HID_GYRATION=y
CONFIG_HID_TWINHAN=y
CONFIG_HID_KENSINGTON=y
CONFIG_HID_LOGITECH=y
CONFIG_HID_MAGICMOUSE=y
CONFIG_HID_MICROSOFT=y
CONFIG_HID_MONTEREY=y
CONFIG_HID_PANTHERLORD=y
CONFIG_HID_PETALYNX=y
CONFIG_HID_SAMSUNG=y
CONFIG_HID_SUNPLUS=y
CONFIG_HID_GREENASIA=y
CONFIG_HID_SMARTJOYPLUS=y
CONFIG_HID_TOPSEED=y
CONFIG_HID_THRUSTMASTER=y
CONFIG_HID_ZEROPLUS=y
CONFIG_USB_STORAGE=y
CONFIG_USB_STORAGE_DATAFAB=y
CONFIG_USB_STORAGE_FREECOM=y
CONFIG_USB_STORAGE_ISD200=y
CONFIG_USB_STORAGE_USBAT=y
CONFIG_USB_STORAGE_SDDR09=y
CONFIG_USB_STORAGE_SDDR55=y
CONFIG_USB_STORAGE_JUMPSHOT=y
CONFIG_USB_STORAGE_ALAUDA=y
CONFIG_USB_STORAGE_ONETOUCH=y
CONFIG_USB_STORAGE_KARMA=y
CONFIG_USB_STORAGE_CYPRESS_ATACB=y
CONFIG_USB_TRANCEVIBRATOR=y
CONFIG_NOP_USB_XCEIV=y
CONFIG_USB_GADGET_VBUS_DRAW=500
CONFIG_USB_CONFIGFS_SERIAL=y
CONFIG_USB_CONFIGFS_ACM=y
CONFIG_USB_CONFIGFS_RNDIS=y
CONFIG_USB_CONFIGFS_MASS_STORAGE=y
CONFIG_USB_CONFIGFS_MTK_FASTMETA=y
CONFIG_USB_CONFIGFS_F_HID=y
CONFIG_MMC=y
CONFIG_MMC_BLOCK_MINORS=32
#CONFIG_MMC_CRYPTO=y
CONFIG_TCT_DEVICEINFO=y
CONFIG_TCT_DEVICEINFO_UFS=y
CONFIG_MTK_EMMC_SUPPORT_OTP=y
CONFIG_MMC_CQHCI=y
CONFIG_MMC_MTK=y
CONFIG_NEW_LEDS=y
CONFIG_LEDS_CLASS=y
CONFIG_LEDS_CLASS_FLASH=y
CONFIG_LEDS_TRIGGERS=y
CONFIG_LEDS_TRIGGER_TIMER=y
# CONFIG_RTC_SYSTOHC is not set
CONFIG_RTC_DRV_MT6358=y
CONFIG_DMADEVICES=y
CONFIG_MTK_UART_APDMA=y
CONFIG_SW_SYNC=y
CONFIG_ANDROID_INTF_ALARM_DEV=y
CONFIG_ION=y
CONFIG_MTK_ION=y
CONFIG_MTK_IOMMU_V2=y
CONFIG_MTK_IOMMU_PGTABLE_EXT=34
CONFIG_RPMSG_MTK=y
CONFIG_MTK_PMIC_WRAP=y
CONFIG_MTK_IPI=y
CONFIG_MTK_MBOX=y
CONFIG_IIO=y
CONFIG_IIO_BUFFER=y
CONFIG_IIO_KFIFO_BUF=y
CONFIG_MEDIATEK_MT6577_AUXADC=y
CONFIG_MT635X_AUXADC=y
CONFIG_PWM=y
CONFIG_PWM_MTK_DISP=y
CONFIG_PHY_MTK_TPHY=y
CONFIG_MTK_DEVINFO=y
CONFIG_EXT4_DEBUG=y
CONFIG_FS_ENCRYPTION_INLINE_CRYPT=y
CONFIG_QUOTA_NETLINK_INTERFACE=y
CONFIG_INCREMENTAL_FS=y
CONFIG_ISO9660_FS=y
CONFIG_JOLIET=y
CONFIG_ZISOFS=y
CONFIG_MSDOS_FS=y
CONFIG_VFAT_FS=y
CONFIG_SDCARD_FS=y
# add for hdt2 tmpfs
CONFIG_TMPFS_POSIX_ACL=y
CONFIG_TMPFS_XATTR=y
CONFIG_F2FS_FS=y
CONFIG_F2FS_FS_SECURITY=y
CONFIG_F2FS_FS_ENCRYPTION=y
CONFIG_F2FS_TCT_RESERVED=y
CONFIG_EXFAT_FS=y
CONFIG_PSTORE=y
CONFIG_PSTORE_CONSOLE=y
CONFIG_PSTORE_PMSG=y
CONFIG_PSTORE_RAM=y
# CONFIG_NETWORK_FILESYSTEMS is not set
CONFIG_NLS_CODEPAGE_437=y
CONFIG_NLS_CODEPAGE_950=y
CONFIG_NLS_ASCII=y
CONFIG_NLS_ISO8859_1=y
CONFIG_NLS_UTF8=y
CONFIG_STATIC_USERMODEHELPER=y
CONFIG_STATIC_USERMODEHELPER_PATH="/system_ext/bin/aee_core_forwarder"
CONFIG_CRYPTO_TWOFISH=y
# CONFIG_CRYPTO_HW is not set
CONFIG_CRC8=y
CONFIG_PRINTK_TIME=y
CONFIG_DYNAMIC_DEBUG=y
CONFIG_DEBUG_INFO=y
CONFIG_FRAME_WARN=3600
CONFIG_PAGE_OWNER=y
CONFIG_DEBUG_SECTION_MISMATCH=y
CONFIG_DEBUG_PAGEALLOC=y
CONFIG_DEBUG_PAGEALLOC_ENABLE_DEFAULT=y
CONFIG_SLUB_DEBUG_ON=y
CONFIG_DEBUG_KMEMLEAK=y
CONFIG_DEBUG_KMEMLEAK_EARLY_LOG_SIZE=6400
CONFIG_DEBUG_KMEMLEAK_DEFAULT_OFF=y
CONFIG_DEBUG_VIRTUAL=y
CONFIG_PANIC_ON_OOPS=y
CONFIG_PANIC_TIMEOUT=5
CONFIG_SCHEDSTATS=y
CONFIG_SCHED_STACK_END_CHECK=y
CONFIG_PROVE_LOCKING=y
CONFIG_DEBUG_LOCKDEP=y
CONFIG_DEBUG_ATOMIC_SLEEP=y
CONFIG_MTK_LOCKING_AEE=y
CONFIG_RCU_CPU_STALL_TIMEOUT=15
CONFIG_RCU_TRACE=y
CONFIG_FAULT_INJECTION=y
CONFIG_DMA_API_DEBUG=y
CONFIG_BUG_ON_DATA_CORRUPTION=y
CONFIG_KGDB=y
CONFIG_KGDB_KDB=y
CONFIG_MTK_MUSB_PHY=n

#Begin ersen.shang for SOCAOSP13-6985 EncoreTF Camera BringUp 2022-06
CONFIG_TCT_PROJECT_ENCORE=y
#End   ersen.shang for SOCAOSP13-6985 EncoreTF Camera BringUp 2022-06

CONFIG_MTK_TINYSYS_MCUPM_SUPPORT=y
CONFIG_TEE=y
CONFIG_MTK_TEE_SUPPORT=y
CONFIG_MTK_TEE_GP_SUPPORT=y
CONFIG_TRUSTONIC_TEE_SUPPORT=y
CONFIG_TRUSTONIC_TEE_VERSION=500

#wanying.chen porting audio 2022.3.1
##CONFIG_SND_SOC_AW87935_V2=y
#add begin by haimei.liu@tcl.com.task:11061043.2021/4/29.audio speaker pa aw87359 porting.
#CONFIG_SND_SOC_AW87359=y
#CONFIG_SND_SOC_AW87XXX=y
CONFIG_SND_SOC_AW87XXX_V2=y
#add end by haimei.liu@tcl.com.task:11061043.2021/4/29.audio speaker pa aw87359 porting.

#[TCT-SPD][PERF]jimeng.zhang added for buffallo TMO 20220302
#for uiturbo
CONFIG_NR_CPUS=8
CONFIG_PELT_HALFLIFE_16=y
# Task-11664832, limit cpu of mediascanner
CONFIG_TCT_LIMIT_MEDIASCANNER=y
CONFIG_F2FS_TCT_EXT=y
#[TCT-SPD][PERF]jimeng.zhang added end
#qiaozhen.li for finger begain
CONFIG_MTK_FINGERPRINT_SUPPORT=y
CONFIG_FINGERPRINT_FOCALTECH_TCT=y
#CONFIG_SUNWAVEFP_FINGERPRINT=y
# Begin added by weizhen.pang for EncoreVZW FR ENCOREVZW-6415 on 20221011
CONFIG_FINGERPRINT_FORTSENSE_FP=y
# end added by weizhen.pang for EncoreVZW FR ENCOREVZW-6415 on 20221011
#qiaozhen.li for finger end
# Begin add by bing-zhang for BUTF-5314 on 2022/03/25
CONFIG_PLUGOUT_CHARGER_LCD_BLINK_POWEROFF=y
# End add by bing-zhang for BUTF-5314 on 2022/03/25
CONFIG_TCT_FEATURE_BACKLIGHT_MAPPING=y

#Begin add by bing-zhang for ENCORETF-21 on 2022/07/29
CONFIG_TCT_FEATURE_HBM=y
#End add by bing-zhang for ENCORETF-21 on 2022/07/29

# Begin add by junhui.liu.cd for ENCORETF-7895 on 2022/11/03
CONFIG_CUSTOM_KERNEL_SITUATION=y
CONFIG_MTK_WAKEHUB=y
# End add by junhui.liu.cd for ENCORETF-7895 on 2022/11/03

CONFIG_MTK_SEC_VIDEO_PATH_SUPPORT=y
CONFIG_MTK_DRM_KEY_MNG_SUPPORT=y
CONFIG_MTK_SVP_ON_MTEE_SUPPORT=y
```
