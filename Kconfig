## drivers/misc/mediatek/leds/Kconfig
```kconfig
config MTK_LEDS
	tristate "MediaTek LED Support"
	depends on LEDS_CLASS
	help
	  This selects the MediaTek(R) LEDs connected to MediaTek chips.
	  If you want to use MediaTek(R) LEDs support, say Y or M here.
	  If unsure, say N.
	  Mediatek LED module includes backlight,
	  indicate LED, keypad LED, button LED etc.

config LIGHTNESS_MAPPING_VALUE
	int "Backlight brightness mapping value"
	default 255
	help
	  Backlight brightness mapping value, from 0 to 255.


#Begin meng.zhang for 2047 level to 1024 pwn output
if BACKLIGHT_2047LEVEL_TO_1024PWM_MAPPING
config LIGHTNESS_MAPPING_VALUE
	int "Backlight brightness mapping value"
	default 2047
	---help---
	  Backlight brightness mapping value, from 0 to 2047.
endif
#End meng.zhang for 2047 level to 1024 pwn output

# Begin add by bing-zhang for 11671805 on 2021/11/15
config BACKLIGHT_2047LEVEL_TO_1024PWM_MAPPING_AUSTINTF
	bool "Backlight brightness mapping value"
	default n
	---help---
	  Backlight brightness mapping value, from 0 to 2047.
# End add by bing-zhang for 11671805 on 2021/11/15

#Begin add by jingqing.yan for aod mode 2021.11.25
config TCT_FEATURE_AOD_FUNCTION
	bool "support aod mode enable"
	default n
	help
	  AOD mode enable.
	  Set y to support.
	  Set n to disable.
	  For aod mode enable.
#End add by jingqing.yan for aod mode 2021.11.25

#Begin add by jiaxin.pi for sonata backlight curve 2022.7.13
config TCT_PROJECT_SONATA_BACKLIGHT_CURVE
        bool "sonata backlight curve enable"
        default n
        help
          sonata backlight curve
#End add by jiaxin.pi for sonata backlight curve 2022.7.13

config BACKLIGHT_SUPPORT_LP8557
	bool "Support backlight lp8557 board"
	default n
	help
	  LED driver for LP8557 support.
	  Set y to support.
	  Set n to disable.
	  For pwm external backlight.

config BACKLIGHT_SUPPORT_LM3697
	bool "LM3697(DW8832) Support"
	default n
	help
	  LED driver for lm3697(dw8832) support.
	  Set y to support.
	  Set n to disable.
	  Charge pump driver for external backlight.

config LEDS_MT6357
	tristate "LED Support for Mediatek MT6357 PMIC"
	depends on LEDS_CLASS
	help
	  This option enables support for on-chip LED drivers found on
	  Mediatek MT6357 PMIC.
	  If you want to use MediaTek(R) LEDs support, say Y or M here.
	  If unsure, say N.


config LEDS_MTK_DISP
	tristate "Mediatek display LED support"
	depends on LEDS_CLASS
	---help---
	  This option enables support for Mediatek display LEDs.
	  say 'y' to enable this
          Set n to disable.
	  To compile this driver as a module, the module will be called leds-mtk-disp.

config LEDS_MTK_PWM
	tristate "Mediatek pwm LED support"
	depends on LEDS_CLASS
	depends on PWM_MTK_DISP
	help
	  This option enables support for Mediatek pwm LEDs.
	  say 'y' to enable this

	  To compile this driver as a module, choose 'M' here: the module
	  will be called leds-mtk-pwm.

config LEDS_MTK_I2C
	tristate "Mediatek i2c LED support"
	depends on LEDS_CLASS
	help
	  This option enables support for Mediatek i2c LEDs.
	  say 'y' to enable this

	  To compile this driver as a module, choose 'M' here: the module
	  will be called leds-mtk-i2c.

config CONTROL_BL_TEMPERATURE
	bool "Support backlight controlled by thermal"
	---help---
	  This option enables support thermal to set max brightness.
	  Set y to support.
	  Set n to not support.
	  This option enables means thermal can set brightness by the api of led driver.
```

## drivers/misc/mediatek/mtprof/Kconfig
```kconfig
config MTPROF
	tristate "Enable MTK profiler/debugger tool"
	default n
	help
	  CONFIG_MTPROF define if mtk profiling/debugger tools should be
	  built-in, module or not. It includes bootprof logger which is for
	  boot time profiling. If you are not sure about whether to
	  enable it or not, please set n.

config MTK_SCHED_MONITOR
	bool "mtk scheduler monitor"
	help
	  MTK_SCHED_MONITOR is used to monitor ISR/SOFTIRQ/TASKLET/HRTIMER
	  /STIMER/RCU processing duration and IRQ disabled duration. Say Y
	  here to enable monitor. If you are not sure about whether to enable
	  it or not, please set n.

config MTK_IRQ_COUNT_TRACER
	bool "mtk irq count tracer"
	depends on MTK_SCHED_MONITOR
	help
	  Enable this to check the increment of irq counts in a period of
	  time. If the increment is above a threshold, a warning message
	  is printed for reference information. This feature is helpful
	  to catch the irq that triggered abnormally.

	  If unsure, say N.

config MTK_IRQ_OFF_TRACER
	bool "mtk irq off tracer"
	depends on MTK_SCHED_MONITOR
	select TRACE_IRQFLAGS
	help
	  Enable this to check the irq off time. If the time is above a
	  threshold, a warning message is printed for reference information.
	  This feature is helpful to catch the task that disable irq for a
	  long time.

	  If unsure, say N.

config MTK_PREEMPT_TRACER
	bool "mtk preempt off tracer"
	depends on MTK_SCHED_MONITOR
	select PREEMPT_TRACER
	help
	  Enable this to check the irq off time. If the time is above a
	  threshold, a warning message is printed for reference information.
	  This feature is helpful to catch the task that disable irq for a
	  long time.

	  If unsure, say N.

config TCL_BOOT_DETECT
	bool "TCL BOOT Failed ,mtprof will display Error information "
	default n
	help
	  Select Y if you have such function.
	  If unsure select "N".

config TCL_FORCE_BOOT_DETECT
	bool "TCL BOOT Failed ,mtprof will force display Error information all version "
	default n
	help
	  Select Y if you have such function.
	  If unsure select "N".

config LONG_VOLUPKEY_LOG_STORE
  default n
	bool "LONG_POWERKEY_LOG_STORE Function "
	help
	  Select Y if you have such function.
	  If unsure select "N".

config TCL_FORCE_DAILY_KEY_DETECT
	bool "TCL Key Press 5 senconds Failed ,mtprof will force display Error information Daily version "
	default n
	help
	  Select Y if you have such function.
	  If unsure select "N".

config HELAEYE_BSP_EMMC_UFS_SD_ON
	bool "Hela Eye emmc/ufs/sd driver tracker "
	depends on TKPERF
	help
	  Select Y if you have such function.
	  If unsure select "N".

config HELAEYE_BSP_TP_ON
	bool "Hela Eye emmc/ufs/sd driver tracker "
	depends on TKPERF
	help
	  Select Y if you have such function.
	  If unsure select "N".

config HELAEYE_BSP_TMO24H_TCP_RETRAN_ON
	bool "Hela tcp/ip 5228 port GMS GCM tracker "
	depends on TKPERF
	help
	  Select Y if you have such function.
	  If unsure select "N".

config HELAEYE_BSP_ABFOTA_ON
	bool "Hela AB FOTA AB_retry_count tracker "
	depends on TKPERF
	help
	  Select Y if you have such function.
	  If unsure select "N".


config HELAEYE_BSP_THERMAL_ON
	bool "Hela Eye thermal tracking "
	depends on TKPERF
	help
	  Select Y if you have such function.
	  If unsure select "N".

config HELAEYE_BSP_LCD_ON
	bool "Hela Eye lcd driver tracker "
	depends on TKPERF
	help
	  Select Y if you have such function.
	  If unsure select "N".

config HELAEYE_BSP_MODEMCRASH_ON
	bool "Hela modem crash trigger "
	depends on TKPERF
	help
	  To support Hela modem crash trigger  feature, if yes,
	  then it is supported, if no,
	  it is disabled.
	  The option default disabled.

config HELAEYE_BSP_SENSOR_ON
	bool "Hela Eye sensor driver tracker "
	depends on TKPERF
	help
	  Select Y if you have such function.
	  If unsure select "N".

config HELAEYE_BSP_CHARGER_ON
	bool "Hela Eye charger driver tracker "
	depends on TKPERF
	help
	  Select Y if you have such function.
	  If unsure select "N".

config HELAEYE_BSP_BOOT_ON
	bool "Hela Eye boot driver tracker "
	depends on TKPERF
	help
	  Select Y if you have such function.
	  If unsure select "N".
	  
config HELAEYE_BSP_AUDIO_ON
	bool "Hela Eye audio driver tracking "
	depends on TKPERF
	help
	  Select Y if you have such function.
	  If unsure select "N". 

config HELAEYE_BSP_OOM
        bool "Hela Eye oom driver tracking "
        depends on TKPERF
        help
          Select Y if you have such function.
          If unsure select "N".

config HELAEYE_BSP_HUNG_TASK
        bool "Hela Eye hung task driver tracking "
        depends on TKPERF
        help
          Select Y if you have such function.
          If unsure select "N".

config TCT_MP2_BLUESCREEN
        bool "MP_BRANCH_VALUE=2 BLUESCERRN WILL Control BY UART FLAG=O ,depend CONFIG_TCL_BOOT_DETECT "
        depends on TCL_BOOT_DETECT
        help
          Select Y if you have such function.
          If unsure select "N".
```

## kernel/Kconfig.freezer
```kconfig
config FREEZER
	def_bool PM_SLEEP || CGROUP_FREEZER

config TCT_IOLIMIT
    def_bool n
	help
	  limite io read or write when process in the cgroup
```
