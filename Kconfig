## drivers/input/fingerprint/TCT-fingerprint/chipone_fp/Kconfig
```kconfig
config FINGERPRINT_CHIPONE_TCT
    tristate "Chipone Finger Print Driver"
    help
        Chipone Finger Print Supported
```

## drivers/input/fingerprint/TCT-fingerprint/regulator/Kconfig
```kconfig
config FINGERPRINT_REGULATOR_MT6371
    tristate "Fingerprint regulator use MT6371 VOUT_LDO"
    default n
    help
      If you say Y to this option, support will be use ldo for
      the fingerprint regulator.
```

## drivers/input/fingerprint/buffalotmo/sunwave_fp/Kconfig
```kconfig
config SUNWAVEFP_FINGERPRINT
       tristate "Sunwave Fingerprint"
       default n
       help
          SUNWAVECORP Fingerprint
```

## drivers/input/hallsensor_2/Kconfig
```kconfig
config HALL_SWITCH_2
	tristate "Hall Switch driver"
	default n
	---help---
	  Say Y here for supporting Hall Switch.
```

## drivers/input/touchscreen/dohatmo_ft8756_touch/Kconfig
```kconfig
#
# Focaltech Touchscreen driver configuration
#

config TOUCHSCREEN_FTS_DIRECTORY
    string "Focaltech ts directory name"
    default "focaltech_touch"
    depends on TOUCHSCREEN_PRAGUE_FT8756_HD720 
   
```

## drivers/input/touchscreen/mediatek/Focaltech_Touch_FT8057_xe671/Kconfig
```kconfig
#
# Focaltech Touchscreen driver configuration
#

config TOUCHSCREEN_FT8057_XE671
    bool "Focaltech Touchscreen"
    default n
    help
      Say Y here if you have Focaltech touch panel.
      If unsure, say N.
      
config TOUCHSCREEN_FTS_DIRECTORY
    string "Focaltech ts directory name"
    default "focaltech_touch"
    depends on TOUCHSCREEN_FTS
    
```

## drivers/input/touchscreen/mediatek/Kconfig
```kconfig
#
# Touchscreen driver configuration
#
menuconfig INPUT_TOUCHSCREEN
	bool "Touchscreens"
	help
	  Say Y here, and a list of supported touchscreens will be displayed.
	  This option doesn't affect the kernel.

	  If unsure, say Y.

if INPUT_TOUCHSCREEN

config TOUCHSCREEN_MTK
	bool "MediaTek Touch Panel Driver"
        default n
	help
	  Say Y here if you have MediaTek touch panel.

	  If unsure, say N.

	  To compile this dirver as a module, choose M here: the
	  module will be called.

config TOUCHSCREEN_PHYSICAL_ROTATION_WITH_LCM
	bool "MediaTek Touch Panel Rotation With LCM"
	default y
	help
	  Say N here if touch panel is not physical rotated as LCM does.
	  Physically rotated means that this driver will map
	  the reported coordination to diagonal position.

	  If unsure, say Y.
	  
config TOUCHSCREEN_MTK_SOLOMON
	bool "SOLOMON for Mediatek package"
	default n
	help
	  Say Y here if you have SOLOMON touch panel.

	  If unsure, say N.

	  To compile this dirver as a module, choose M here: the
	  module will be called.


config TOUCHSCREEN_MTK_FOCALTECH_TS
	bool "FOCALTECH_TS for Mediatek package"
	default n
	help
	  Say Y here if you have focaltech_touch touch panel.

	  If unsure, say N.

	  To compile this dirver as a module, choose M here: the
	  module will be called.

source "drivers/input/touchscreen/mediatek/focaltech_touch/Kconfig"

config TOUCHSCREEN_MTK_GT1151
	bool "GT1151 for Mediatek package"
	default n
	help
	  Say Y here if you have GT1151 touch panel.

	  If unsure, say N.

	  To compile this dirver as a module, choose M here: the
	  module will be called.

source "drivers/input/touchscreen/mediatek/GT1151/Kconfig"

config TOUCHSCREEN_MTK_GSLX680
	bool "gslX680 for Mediatek package"
	help
	  Say Y here if you have gslX680 touch panel.

	  If unsure, say N.

	  you can config it if you want to use MTK9XX_LM for
	  touch panel.

config TOUCHSCREEN_MTK_NT36xxx
	bool "NT36xxx for Mediatek package"
	default n
	help
	  Say Y here if you have NT36xxx touch panel.

	  If unsure, say N.

	  To compile this dirver as a module, choose M here: the
	  module will be called.

source "drivers/input/touchscreen/mediatek/NT36xxx/Kconfig"

config TOUCHSCREEN_MTK_GT9XX_LM
	bool "GT9XX_LM for Mediatek package"
	help
	  Say Y here if you have GT9XX_LM touch panel.

	  If unsure, say N.

	  you can config it if you want to use MTK9XX_LM for
	  touch panel.

source "drivers/input/touchscreen/mediatek/GT9XX_LM/Kconfig"

config TOUCHSCREEN_FT5X26
	bool "FT5X26 for Mediatek package"
	help
	  Say Y here if you have FT5X26 touch panel.

	  If unsure, say N.

	  To compile this dirver as a module, choose M here: the
	  module will be called.

config TOUCHSCREEN_FT5X26_WUXGA
	bool "FT5X26 WUXGA for Mediatek package"
	help
	  Say Y here if you have FT5X26 touch panel.

	  If unsure, say N.

	  To compile this dirver as a module, choose M here: the
	  module will be called.

source "drivers/input/touchscreen/mediatek/FT5X26/Kconfig"

config TOUCHSCREEN_MTK_GT5688
	bool "GT1151 for Mediatek package"
	help
	  Say Y here if you have GT5688 touch panel.

	  If unsure, say N.

	  To compile this dirver as a module, choose M here: the
	  module will be called.

source "drivers/input/touchscreen/mediatek/GT5688/Kconfig"
source "drivers/input/touchscreen/mediatek/hxchipset/Kconfig"

config TOUCHSCREEN_HIMAX_CHIPSET_8789P1_8185P3
	bool "hxchipset for Mediatek 8789p1 and 8185p3 package"
	default n
	help
	  Say Y here if you have hxchipset touch panel.

	  If unsure, say N.

	  To compile this dirver as a module, choose M here: the
	  module will be called.

source "drivers/input/touchscreen/mediatek/hxchipset_8789p1_8185p3/Kconfig"

config TOUCHSCREEN_MTK_GT911
	bool "GT911 for Mediatek package"
	help
	  Say Y here if you have GT911 touch panel.

	  If unsure, say N.
	  this is a GT911 touch driver config, you can use it
	  if you want.

source "drivers/input/touchscreen/mediatek/GT911/Kconfig"

config TOUCHSCREEN_MTK_FOCALTECH_FHD
	bool "Focaltech FHD Touchscreen"
	depends on I2C
	help
	  Say Y here if you have Focaltech touch panel.
	  If unsure, say N.

config TOUCHSCREEN_MTK_GT9157
	bool "GT9157 for Mediatek package"
	help
	  Say Y here if you have GT9157 touch panel.

	  If unsure, say N.

	  To compile this dirver as a module, choose M here: the
	  module will be called

source "drivers/input/touchscreen/mediatek/GT9157/Kconfig"

config TOUCHSCREEN_HIMAX_CHIPSET
	bool "Himax touchpanel CHIPSET"
	depends on SPI
	help
	Say Y here if you have a Himax CHIPSET touchscreen.
	HIMAX controllers are multi touch controllers which can
	report 10 touches at a time.

	If unsure, say N.
source "drivers/input/touchscreen/mediatek/hxchipset_hx83102p/Kconfig"


config TOUCHSCREEN_MTK_GT1151_BANGKOKTF
    bool "CONFIG_TOUCHSCREEN_MTK_GT1151_BANGKOKTF"
    default n
    help
      Say Y here if you have Focaltech touch panel.
      If unsure, say N.
source "drivers/input/touchscreen/mediatek/bangkoktf_GT1151/Kconfig"

config TOUCHSCREEN_MTK_FT5446_BANGKOKTF
	bool "fermi att ft5446 for Mediatek package"
	default n
	help
	  Say Y here if you have ft5446 touch panel.

	  If unsure, say N.

	  To compile this dirver as a module, choose M here: the
	  module will be called.
source "drivers/input/touchscreen/mediatek/bangkoktf_ft5446/Kconfig"

config TOUCHSCREEN_MTK_CHSC5XXX_BANGKOKTF
	bool "bangkoktf chsc5xxx for Mediatek package"
	default n
	help
	  Say Y here if you have chsc5xxx touch panel.

	  If unsure, say N.

	  To compile this dirver as a module, choose M here: the
	  module will be called.
source "drivers/input/touchscreen/mediatek/bangkoktf_CHSC5XXX/Kconfig"

config TOUCHSCREEN_MTK_CHSC5XXX_JETTA
	bool "bangkoktf chsc5xxx for Mediatek package"
	default n
	help
	  Say Y here if you have chsc5xxx touch panel.

	  If unsure, say N.

	  To compile this dirver as a module, choose M here: the
	  module will be called.
source "drivers/input/touchscreen/mediatek/jetta_chsc5xxx/Kconfig"

config TOUCHSCREEN_MTK_CHIPONE_JETTA
	bool "jetta chipone-ts for Mediatek package"
	default n
	help
	  Say Y here if you have chipone-ts touch panel.

	  If unsure, say N.

	  To compile this dirver as a module, choose M here: the
	  module will be called.


config TOUCHSCREEN_MTK_BETTERLIFE_BANGKOKTF
	bool "bangkoktf betterlife for Mediatek package"
	default n
	help
	  Say Y here if you have betterlife touch panel.

	  If unsure, say N.

	  To compile this dirver as a module, choose M here: the
	  module will be called.
source "drivers/input/touchscreen/mediatek/bangkoktf_betterlife_ts/Kconfig"
config TOUCHSCREEN_GOODIX_BRL
	bool "Goodix berlin touchscreen"
	help
	  Say Y here if you have a Goodix berlin series touch controller
	  to your system.

	  If build module, say M.
	  If unsure, say N.
source "drivers/input/touchscreen/mediatek/goodix_berlin_driver/Kconfig"

config BUFFALOTMO_GC7202_TOUCH
	bool "GC7202 for tct touch"
	default n
	help
	  Say Y here if you have GC7202 touch panel.

	  If unsure, say N.

	  you can config it if you want to use GC7202 for
	  touch panel.

#Begin added by liangjiaqiang for MODEL3-1881 on 2022-09-09
source "drivers/input/touchscreen/mediatek/chipone-tddi_xe671/Kconfig"
#End added by liangjiaqiang for MODEL3-1881 on 2022-09-09

#Begin added by liangjiaqiang for MODEL3-4765 on 2022-11-16
source "drivers/input/touchscreen/mediatek/Focaltech_Touch_FT8057_xe671/Kconfig"
#End added by liangjiaqiang for MODEL3-4765 on 2022-11-16

endif
config TOUCHSCREEN_MTK_APOLLO_GT912
    bool "APOLLO_GT912"
    default n
    help
      Say Y here if you have Focaltech touch panel.
      If unsure, say N.
source "drivers/input/touchscreen/mediatek/apollo_gt912/Kconfig"

#Begin added by yan.gong for CIVIC-3003 on 2022-07-12
config TOUCHSCREEN_CHIPONE_CIVI
	bool "touchscreen chipone civi"
	help
	  Say Y here if you have a Goodix berlin series touch controller
	  to your system.

	  If unsure, say N.
source "drivers/input/touchscreen/mediatek/chipone-tddi/Kconfig"
source "drivers/input/touchscreen/mediatek/Focaltech_Touch_FT8057/Kconfig"

config TOUCHSCREEN_PROXIMITY_ENABLE
	bool "enable tp proximity"
	default n

#End added by yan.gong for CIVIC-3003 on 2022-07-12

#Add-start by jiaxin.pi for tp bl7401 porting on 2021/07/06
config TOUCHSCREEN_MTK_APOLLO_BL7401
    bool "APOLLO_BL7401"
    default n
    help
      Say Y here if you have Focaltech touch panel.
      If unsure, say N.
source "drivers/input/touchscreen/mediatek/apollo_bl7401/Kconfig"

config ODIN_CHSC5XXX_TOUCH
	bool "CHSC5XXX for tct touch"
	default n
	help
	  Say Y here if you have CHSC5XXX touch panel.
	  If unsure, say N.
source "drivers/input/touchscreen/mediatek/odin_chsc5xxx_touch/Kconfig"
source "drivers/input/touchscreen/mediatek/odin_focaltech_touch/Kconfig"

source "drivers/input/touchscreen/mediatek/luna_chsc5xxx_wxga_i2c_touch/Kconfig"
source "drivers/input/touchscreen/mediatek/luna_focaltech_wxga_i2c_touch/Kconfig"
```

## drivers/input/touchscreen/mediatek/chipone-tddi/Kconfig
```kconfig
config TOUCHSCREEN_CHIPONE_CIVI
	tristate "Chipone TDDI touchscreen for Mediatek package"
	default n
	help
	  Say y here if you have chipone TDDI touch panel.
	  If unsure, say N.

config TP_PROXIMITY_SLEEP_CONTROLL_IN_BSP
	bool "tp ps power control in bsp"
	default n
```

## drivers/input/touchscreen/mediatek/chipone-tddi_xe671/Kconfig
```kconfig
config TOUCHSCREEN_CHIPONE_XE671
	tristate "Chipone TDDI XE671 touchscreen for Mediatek package"
	default n
	help
	  Say y here if you have chipone TDDI touch panel.
	  If unsure, say N.
```

## drivers/misc/mediatek/accdet/Kconfig
```kconfig
config MTK_ACCDET
	bool "MediaTek ACCDET driver"
	help
	  ACCDET driver is for headset detect and support for MediaTek SOC
	  If you want to use MediaTek ACCDET driver,
	  say Y.
	  If unsure, say N.

config ACCDET_EINT_IRQ
	bool "MediaTek ACCDET PMIC EINT"
	help
	  ACCDET Internal EINT(PMIC) support for MediaTek SOC
	  If you want to use MediaTek ACCDET EINT from PMIC,
	  say Y.
	  If unsure, say N.

config ACCDET_SUPPORT_EINT0
	bool "MediaTek ACCDET PMIC EINT0"
	help
	  ACCDET use Internal EINT0(PMIC) support for MediaTek SOC
	  If you just want to use MediaTek PMIC ACCDET EINT0,
	  say Y.
	  If unsure, say N.
#Begin added by lanying.he for XR porting on 2022/01/05
config ACCDET_EINT
    bool "MediaTek ACCDET AP EINT"
    help
      ACCDET External EINT(AP GPIO) support for MediaTek SOC
      If you want to use MediaTek ACCDET EINT from AP GPIO,
      say Y.
      If unsure, say N.
config TCT_PROJECT_FAS4480
	bool "TCT PROJECT FAS4480"
	help
	  TCT PROJECT FAS4480
	  If you want to use TCT_PROJECT_FAS4480 driver,
	  say Y.
	  If unsure, say N.
config MTK_FSA4480_I2C
	bool "TCT PROJECT FAS4480"
	help
	  TCT PROJECT FAS4480
	  If you want to use MTK_FSA4480_I2C driver,
	  say Y.
	  If unsure, say N.
#End added by lanying.he for XR porting on 2022/01/05	 
```

## drivers/misc/mediatek/devinfo/Kconfig
```kconfig
config KERNEL_ENV_TCT
	bool "kernel readonly environment, app will use it"
	default n
	help
	  This option enables support for kernel environment
```

## drivers/misc/mediatek/imgsensor/src/Kconfig
```kconfig
config SPECIFY_IMGSENSOR
	bool SPECIFY_IMGSENSOR
	depends on MTK_IMGSENSOR
	help
	  Specify name of each sensor to
	  prevent obtaining wrong sensor driver with same sensor ID.
	  For example, imx258_mipi_raw and imx258_mipi_mono
	  are of same sensor ID. If not specifying
	  sensor, imx258_mipi_mono may be recognized as imx258_mipi_raw.

config IMGSENSOR_MAIN
	string "Custom main image sensor"
	depends on SPECIFY_IMGSENSOR
	help
	  Specify main sensor.
	  This config is mainly mapping to userspace.
	  Consider the numbers of sensors and usage on the phone.
	  Compare the custom usage defined in user-custom folder.

config IMGSENSOR_MAIN2
	string "Custom main2 image sensor"
	depends on SPECIFY_IMGSENSOR
	help
	  Specify main2 sensor.
	  This config is mainly mapping to userspace.
	  Consider the numbers of sensors and usage on the phone.
	  Compare the custom usage defined in user-custom folder.

config IMGSENSOR_SUB
	string "Custom sub image sensor"
	depends on SPECIFY_IMGSENSOR
	help
	  Specify sub sensor.
	  This config is mainly mapping to userspace.
	  Consider the numbers of sensors and usage on the phone.
	  Compare the custom usage defined in user-custom folder.

config IMGSENSOR_SUB2
	string "Custom sub2 image sensor"
	depends on SPECIFY_IMGSENSOR
	help
	  Specify sub2 sensor.
	  This config is mainly mapping to userspace.
	  Consider the numbers of sensors and usage on the phone.
	  Compare the custom usage defined in user-custom folder.

config IMGSENSOR_MAIN3
	string "Custom main3 image sensor"
	depends on SPECIFY_IMGSENSOR
	help
	  Specify main3 sensor.
	  This config is mainly mapping to userspace.
	  Consider the numbers of sensors and usage on the phone.
	  Compare the custom usage defined in user-custom folder.

config TCT_CAM_DRIVER_SUPPORT
	bool TCT_CAM_DRIVER_SUPPORT

config TCT_CAMERA_PROJECT_BUFFALOTMO
 	tristate "build project name of Buffalo"
 	default n
 	help
 	  This option enables when build Buffalo.

config TCT_CAMERA_PROJECT_BUFFALOTF
	tristate "build project name of Buffalotf"
	default n
	help
	  This option enables when build Buffalotf.
```
