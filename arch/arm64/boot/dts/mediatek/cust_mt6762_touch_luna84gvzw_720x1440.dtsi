/*
 * Copyright (C) 2010 - 2018 Novatek, Inc.
 *
 * $Revision: 52935 $
 * $Date: 2019-11-11 10:24:25 +0800 (Mon, 11 Nov 2019) $
 *
 * This program is free software; you can redistribute it and/or modify
 * it under the terms of the GNU General Public License as published by
 * the Free Software Foundation; either version 2 of the License, or
 * (at your option) any later version.
 *
 * This program is distributed in the hope that it will be useful, but WITHOUT
 * ANY WARRANTY; without even the implied warranty of MERCHANTABILITY or
 * FITNESS FOR A PARTICULAR PURPOSE.  See the GNU General Public License for
 * more details.
 *
 */

/*begin add by wenhao.deng for task 11388151 on 20210729*/

/* TOUCH start */
&spi0 {
        #address-cells = <1>;
        #size-cells = <0>;
        status = "okay";
		tct_focaltech_tp@0 {
			compatible = "focaltech,fts";
			reg = <0>;
			spi-max-frequency = <10000000>;
			interrupt-parent = <&pio>;
			interrupts = <0 0x2008>;

			/* ft8006s special */
			focaltech,reset-gpio = <&pio 174 0x00>;
			focaltech,irq-gpio = <&pio 0 0x00>;
			focaltech,max-touch-number = <5>;
			focaltech,display-coords =  <0 0 720 1440>;
         };
};

/* TOUCH end */




