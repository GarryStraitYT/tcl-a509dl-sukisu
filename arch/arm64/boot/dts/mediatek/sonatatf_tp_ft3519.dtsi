/*
 * Copyright (C) 2010 - 2018 Novatek, Inc.
 *
 * $Revision: 52935 $
 * $Date: 2019-11-11 10:24:25 +0800 (Mon, 11 Nov 2019) $
 *
 * This program is free software; you can redistribute it and/or modify
 * it under the terms of the GNU General Public License as published by
 * the Free Software Foundation; either version 2 of the License, or
 * (at your option) any later version.
 *
 * This program is distributed in the hope that it will be useful, but WITHOUT
 * ANY WARRANTY; without even the implied warranty of MERCHANTABILITY or
 * FITNESS FOR A PARTICULAR PURPOSE.  See the GNU General Public License for
 * more details.
 *
 */
//begin add by jingqing.yan for task 11220124  on 2021/06/04
&i2c0 { 
   		#address-cells = <1>;
       		 #size-cells = <0>;
      		 status = "okay";
		focaltech@38{ 
			status = "okay";
			compatible = "focaltech,fts";	
			reg = <0x38>;  					
			interrupt-parent = <&pio>;				
			interrupts = <0 IRQ_TYPE_EDGE_FALLING 0 0>;
		        focaltech,reset-gpio = <&pio 18 0x0>;
                        focaltech,irq-gpio = <&pio 0 0x0>; 	
			focaltech,max-touch-number = <10>;			
			focaltech,display-coords =  <0 0 1080 2400>;	 
			spi-max-frequency = <4000000>;
			/*
			pinctrl-names = "pmx_ts_active","pmx_ts_suspend","pmx_ts_release";
			pinctrl-0 = <&ts_int_active &ts_reset_active>;
			pinctrl-1 = <&ts_int_suspend &ts_reset_suspend>;
			pinctrl-2 = <&ts_release>;
			*/
			/*
			focaltech,have-key;
			focaltech,key-number = <3>;	
			focaltech,keys = <139 102 158>; 	
			focaltech,key-x-coords = <200 600 800>;
			focaltech,key-y-coords = <2000 2000 2000>; 
			*/
		};
	}; 
	
