/*
 * Copyright (C) 2010 - 2018 Novatek, Inc.
 *
 * $Revision: 52935 $
 * $Date: 2019-11-11 10:24:25 +0800 (Mon, 11 Nov 2019) $
 *
 * This program is free software; you can redistribute it and/or modify
 * it under the terms of the GNU General Public License as published by
 * the Free Software Foundation; either version 2 of the License, or
 * (at your option) any later version.
 *
 * This program is distributed in the hope that it will be useful, but WITHOUT
 * ANY WARRANTY; without even the implied warranty of MERCHANTABILITY or
 * FITNESS FOR A PARTICULAR PURPOSE.  See the GNU General Public License for
 * more details.
 *
 */

/*begin add by wenhao.deng for task 11388151 on 20210729*/

/* TOUCH start */
&spi0 {
        #address-cells = <1>;
        #size-cells = <0>;
        status = "okay";
	tct_touch@0 {
		compatible = "tct,touch";
		reg = <0>;
		spi-max-frequency = <10000000>;
		interrupt-parent = <&pio>;
		interrupts = <0 0x2008>;
		//chipone,rst-gpio = <&pio 46 0x00>;
		//chipone,irq-gpio = <&pio 0 0x00>;
		//chipone,x-res = <720>;
		//chipone,y-res = <1640>;

		//Add for 2nd TP novatek begin
		novatek,reset-gpio = <&pio 46 0x00>;
		//Begin add by bing-zhang for 11672345 on 2021/11/15
		novatek,reset-gpio-v1_0 = <&pio 167 0x00>;
		//End add by bing-zhang for 11672345 on 2021/11/15
		novatek,irq-gpio = <&pio 0 0x00>;

		novatek,swrst-n8-addr = <0x03F0FE>;
		novatek,spi-rd-fast-addr = <0x03F310>;
		//Add for 2nd TP novatek end
         };
};

/* TOUCH end */




