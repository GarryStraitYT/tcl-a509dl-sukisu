

&bat_gm30 {
	compatible = "mediatek,bat_gm30";
	io-channels = <&auxadc 3>;
	io-channel-names = "batteryID-channel";
 	HWOCV_SWOCV_DIFF = <3000>;
	HWOCV_OLDOCV_DIFF = <3000>;
        SWOCV_OLDOCV_DIFF = <3000>;
	HWOCV_OLDOCV_DIFF_CHR = <8000>;
	DIFFERENCE_FULLOCV_ITH = <(200)>;	/*	Charging termination current.*/
	SHUTDOWN_1_TIME = <(30)>;	/*	If ui_soc shows 1% more than X minites, system will shutdown.*/
	KEEP_100_PERCENT = <(3)>;	/*	The ui_soc will keep 100% until SOC drop X percents after unplugged.*/
	R_FG_VALUE = <(5)>;	/*	R_sense resistance.*/
	EMBEDDED_SEL = <(1)>;	/*	Configures whether using embedded battery or not.*/
	PSEUDO100_EN = <(1)>;
  PSEUDO100_EN_DIS = <(1)>;
	PMIC_SHUTDOWN_CURRENT = <(20)>;	/*	System shutdown current.*/
	FG_METER_RESISTANCE = <(20)>;	/*	The resistance of PCB*/
	CAR_TUNE_VALUE = <(99)>;	/*	Tune value for current measurement.*/
	PMIC_MIN_VOL = <(34000)>;
	/*	vboot voltage for gauge 0%.*/
	POWERON_SYSTEM_IBOOT = <(500)>;
	/*	power on system iboot*/
	SHUTDOWN_GAUGE0_VOLTAGE = <(34500)>;
	/*	shutdown gauge 0% voltage*/
	g_temperature =
    <
       50/*TEMPERATURE_T0*/
       25/*TEMPERATURE_T1*/
       10/*TEMPERATURE_T2*/
       0/*TEMPERATURE_T3*/
      (-10)/*TEMPERATURE_T4*/
     >;
     g_Q_MAX =
     <
     //BAT1  BAT2  BAT3  BAT4
       4458 4386 3836 3949/*T0*/
       4515 4437 3883 3928/*T1*/
       4466 4472 3856 3937/*T2*/
       4451 4430 3879 3987/*T3*/
       4513 4431 3856 3957/*T4*/ 
     >;
     g_Q_MAX_H_CURRENT =
     <
     //BAT1 BAT2 BAT3 BAT4
       4439 4364 3836 3944/*T0*/
       4510 4407 3855 3908/*T1*/
       4392 4342 3694 3844/*T2*/
       4006 3814 3329 3449/*T3*/
       3372 3135 2580 2472/*T4*/
     >;
     g_FG_PSEUDO1 =
     <
     //BAT1 BAT2 BAT3 BAT4
       2    2    2    2/*T0*/
       2    2    2    2/*T1*/
       2    2    2    2/*T2*/
       2    2    2    2/*T3*/
       2    2    2    2/*T4*/
     >;
     g_FG_PSEUDO100 =
     <
     //BAT1 BAT2 BAT3 BAT4
       97   97   97   97/*T0*/
       97   97   97   97/*T1*/
       97   97   97   97/*T2*/
       92   92   92   92/*T3*/
       90   90   90   90/*T4*/
     >;
     g_PMIC_MIN_VOL =
     <
     //BAT1  BAT2  BAT3  BAT4
       33500 33500 33500 33500/*T0*/
       33500 33500 33500 33500/*T1*/
       33500 33500 33500 33500/*T2*/
       33500 33500 33500 33500/*T3*/
       33500 33500 33500 33500/*T4*/
     >;
     g_PON_SYS_IBOOT =
     <
     //BAT1 BAT2 BAT3 BAT4
       5000 5000 5000 5000/*T0*/
       5000 5000 5000 5000/*T1*/
       5000 5000 5000 5000/*T2*/
       5000 5000 5000 5000/*T3*/
       5000 5000 5000 5000/*T4*/
     >;
     g_QMAX_SYS_VOL =
     <
     //BAT1  BAT2  BAT3  BAT4
       33500 33500 33500 33500/*T0*/
       33500 33500 33500 33500/*T1*/
       33500 33500 33500 33500/*T2*/
       33500 33500 33500 33500/*T3*/
       33500 33500 33500 33500/*T4*/
     >;
     g_SHUTDOWN_HL_ZCV =
     <
     //BAT1 BAT2 BAT3 BAT4
       3400 3400 3400 3400/*T0*/
       3400 3400 3400 3400/*T1*/
       3400 3400 3400 3400/*T2*/
       3400 3400 3400 3400/*T3*/
       3400 3400 3400 3400/*T4*/
     >;
	Q_MAX_SYS_VOLTAGE_BAT0 = <(3350)>;	/*	System shut down voltage.*/
	Q_MAX_SYS_VOLTAGE_BAT1 = <(3350)>;	/*	System shut down voltage.*/
	Q_MAX_SYS_VOLTAGE_BAT2 = <(3350)>;	/*	System shut down voltage.*/
	Q_MAX_SYS_VOLTAGE_BAT3 = <(3350)>;	/*	System shut down voltage.*/

#include "buffalo_battery_table_1st.dtsi"
#include "buffalo_battery_table_2st.dtsi"
};
