/*
 * Copyright (C) 2010 - 2018 Novatek, Inc.
 *
 * $Revision: 52935 $
 * $Date: 2019-11-11 10:24:25 +0800 (Mon, 11 Nov 2019) $
 *
 * This program is free software; you can redistribute it and/or modify
 * it under the terms of the GNU General Public License as published by
 * the Free Software Foundation; either version 2 of the License, or
 * (at your option) any later version.
 *
 * This program is distributed in the hope that it will be useful, but WITHOUT
 * ANY WARRANTY; without even the implied warranty of MERCHANTABILITY or
 * FITNESS FOR A PARTICULAR PURPOSE.  See the GNU General Public License for
 * more details.
 *
 */

&spi0 {
        #address-cells = <1>;
        #size-cells = <0>;
        status = "okay";
        focaltech@0{
               status = "okay";
                compatible = "focaltech,fts";
                reg = <0x0>;
                interrupt-parent = <&pio>;
                interrupts = <0 IRQ_TYPE_EDGE_FALLING 0 0>;
                focaltech,reset-gpio = <&pio 46 0x0>;
                focaltech,irq-gpio = <&pio 0 0x0>;
                focaltech,max-touch-number = <10>;
                focaltech,display-coords =  <0 0 720 1600>;
                spi-max-frequency = <5000000>;
        };
};
