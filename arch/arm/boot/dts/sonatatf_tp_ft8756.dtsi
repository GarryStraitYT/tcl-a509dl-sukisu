/*
 * Copyright (C) 2010 - 2018 Novatek, Inc.
 *
 * $Revision: 52935 $
 * $Date: 2019-11-11 10:24:25 +0800 (Mon, 11 Nov 2019) $
 *
 * This program is free software; you can redistribute it and/or modify
 * it under the terms of the GNU General Public License as published by
 * the Free Software Foundation; either version 2 of the License, or
 * (at your option) any later version.
 *
 * This program is distributed in the hope that it will be useful, but WITHOUT
 * ANY WARRANTY; without even the implied warranty of MERCHANTABILITY or
 * FITNESS FOR A PARTICULAR PURPOSE.  See the GNU General Public License for
 * more details.
 *
 */

&spi0 {
        #address-cells = <1>;
        #size-cells = <0>;
        status = "okay";
        tct,touch@0{
            status = "okay";
            compatible = "tct,touch";
            reg = <0x0>;
            interrupt-parent = <&pio>;
            interrupts = <0 IRQ_TYPE_EDGE_FALLING 0 0>;
            focaltech,reset-gpio = <&pio 11 0x0>;
            focaltech,irq-gpio = <&pio 0 0x0>;
/* Begin jingqing.yan power LCD bias gpio on 20210901 */
            focaltech,bias-neg-gpio = <&pio 171 0x00>;
            focaltech,bias-pos-gpio = <&pio 173 0x00>;
/* End jingqing.yan power LCD bias gpio on 20210901 */
            focaltech,max-touch-number = <5>;
            focaltech,display-coords =  <0 0 720 1600>;
            spi-max-frequency = <5000000>;
			/*Begind For ICNL9911C*/
			touch,reset-gpio = <&pio 11 0x00>;
			touch,irq-gpio = <&pio 0 0x00>;
			touch,x-res = <720>;
			touch,y-res = <1600>;
			/*End For ICNL9911C*/
        //};
        //novatek@0 {
            //compatible = "novatek,NVT-ts-spi";
            //reg = <0>; //Same as CS ID
            //status = "ok";

            //spi-max-frequency = <9600000>;	//4800000,9600000,15000000,19200000
            novatek,reset-gpio = <&pio 11 0x0>;
            novatek,irq-gpio = <&pio 0 0x0>;

            /* 525 */
            //novatek,swrst-n8-addr = <0x01F01A>;

            /* 672A, 525B, 675, 526, 672C */
            novatek,swrst-n8-addr = <0x03F0FE>;
            novatek,spi-rd-fast-addr = <0x03F310>;

            /* MP */
            novatek,mp-support-dt;

            novatek-mp-criteria-5F67@0 {
                #address-cells = <1>;
                #size-cells = <0>;
                compatible = "novatek-mp-criteria-5F67";

                /* MP Config */
                IC_X_CFG_SIZE = <18>;
                IC_Y_CFG_SIZE = <32>;
                IC_KEY_CFG_SIZE = <4>;
                X_Channel = <18>;
                Y_Channel = <32>;
                AIN_X = <0 1 2 3 4 5 6 7 8 9 10 11 12 13 14 15 16 17>;
                AIN_Y = <0 1 2 3 4 5 6 7 8 9 10 11 12 13 14 15 16 17
                            18 19 20 21 22 23 24 25 26 27 28 29 30 31>;
                AIN_KEY = <0 1 2 0xFF>;

                /* MP Criteria */
                PS_Config_Lmt_Short_Rawdata_P = <
                    14100 14100 14100 14100 14100 14100 14100 14100 14100 14100 14100 14100 14100 14100 14100 14100 14100 14100
                    14100 14100 14100 14100 14100 14100 14100 14100 14100 14100 14100 14100 14100 14100 14100 14100 14100 14100
                    14100 14100 14100 14100 14100 14100 14100 14100 14100 14100 14100 14100 14100 14100 14100 14100 14100 14100
                    14100 14100 14100 14100 14100 14100 14100 14100 14100 14100 14100 14100 14100 14100 14100 14100 14100 14100
                    14100 14100 14100 14100 14100 14100 14100 14100 14100 14100 14100 14100 14100 14100 14100 14100 14100 14100
                    14100 14100 14100 14100 14100 14100 14100 14100 14100 14100 14100 14100 14100 14100 14100 14100 14100 14100
                    14100 14100 14100 14100 14100 14100 14100 14100 14100 14100 14100 14100 14100 14100 14100 14100 14100 14100
                    14100 14100 14100 14100 14100 14100 14100 14100 14100 14100 14100 14100 14100 14100 14100 14100 14100 14100
                    14100 14100 14100 14100 14100 14100 14100 14100 14100 14100 14100 14100 14100 14100 14100 14100 14100 14100
                    14100 14100 14100 14100 14100 14100 14100 14100 14100 14100 14100 14100 14100 14100 14100 14100 14100 14100
                    14100 14100 14100 14100 14100 14100 14100 14100 14100 14100 14100 14100 14100 14100 14100 14100 14100 14100
                    14100 14100 14100 14100 14100 14100 14100 14100 14100 14100 14100 14100 14100 14100 14100 14100 14100 14100
                    14100 14100 14100 14100 14100 14100 14100 14100 14100 14100 14100 14100 14100 14100 14100 14100 14100 14100
                    14100 14100 14100 14100 14100 14100 14100 14100 14100 14100 14100 14100 14100 14100 14100 14100 14100 14100
                    14100 14100 14100 14100 14100 14100 14100 14100 14100 14100 14100 14100 14100 14100 14100 14100 14100 14100
                    14100 14100 14100 14100 14100 14100 14100 14100 14100 14100 14100 14100 14100 14100 14100 14100 14100 14100
                    14100 14100 14100 14100 14100 14100 14100 14100 14100 14100 14100 14100 14100 14100 14100 14100 14100 14100
                    14100 14100 14100 14100 14100 14100 14100 14100 14100 14100 14100 14100 14100 14100 14100 14100 14100 14100
                    14100 14100 14100 14100 14100 14100 14100 14100 14100 14100 14100 14100 14100 14100 14100 14100 14100 14100
                    14100 14100 14100 14100 14100 14100 14100 14100 14100 14100 14100 14100 14100 14100 14100 14100 14100 14100
                    14100 14100 14100 14100 14100 14100 14100 14100 14100 14100 14100 14100 14100 14100 14100 14100 14100 14100
                    14100 14100 14100 14100 14100 14100 14100 14100 14100 14100 14100 14100 14100 14100 14100 14100 14100 14100
                    14100 14100 14100 14100 14100 14100 14100 14100 14100 14100 14100 14100 14100 14100 14100 14100 14100 14100
                    14100 14100 14100 14100 14100 14100 14100 14100 14100 14100 14100 14100 14100 14100 14100 14100 14100 14100
                    14100 14100 14100 14100 14100 14100 14100 14100 14100 14100 14100 14100 14100 14100 14100 14100 14100 14100
                    14100 14100 14100 14100 14100 14100 14100 14100 14100 14100 14100 14100 14100 14100 14100 14100 14100 14100
                    14100 14100 14100 14100 14100 14100 14100 14100 14100 14100 14100 14100 14100 14100 14100 14100 14100 14100
                    14100 14100 14100 14100 14100 14100 14100 14100 14100 14100 14100 14100 14100 14100 14100 14100 14100 14100
                    14100 14100 14100 14100 14100 14100 14100 14100 14100 14100 14100 14100 14100 14100 14100 14100 14100 14100
                    14100 14100 14100 14100 14100 14100 14100 14100 14100 14100 14100 14100 14100 14100 14100 14100 14100 14100
                    14100 14100 14100 14100 14100 14100 14100 14100 14100 14100 14100 14100 14100 14100 14100 14100 14100 14100
                    14100 14100 14100 14100 14100 14100 14100 14100 14100 14100 14100 14100 14100 14100 14100 14100 14100 14100>;

                PS_Config_Lmt_Short_Rawdata_N = <
                    11300 11300 11300 11300 11300 11300 11300 11300 11300 11300 11300 11300 11300 11300 11300 11300 11300 11300
                    11300 11300 11300 11300 11300 11300 11300 11300 11300 11300 11300 11300 11300 11300 11300 11300 11300 11300
                    11300 11300 11300 11300 11300 11300 11300 11300 11300 11300 11300 11300 11300 11300 11300 11300 11300 11300
                    11300 11300 11300 11300 11300 11300 11300 11300 11300 11300 11300 11300 11300 11300 11300 11300 11300 11300
                    11300 11300 11300 11300 11300 11300 11300 11300 11300 11300 11300 11300 11300 11300 11300 11300 11300 11300
                    11300 11300 11300 11300 11300 11300 11300 11300 11300 11300 11300 11300 11300 11300 11300 11300 11300 11300
                    11300 11300 11300 11300 11300 11300 11300 11300 11300 11300 11300 11300 11300 11300 11300 11300 11300 11300
                    11300 11300 11300 11300 11300 11300 11300 11300 11300 11300 11300 11300 11300 11300 11300 11300 11300 11300
                    11300 11300 11300 11300 11300 11300 11300 11300 11300 11300 11300 11300 11300 11300 11300 11300 11300 11300
                    11300 11300 11300 11300 11300 11300 11300 11300 11300 11300 11300 11300 11300 11300 11300 11300 11300 11300
                    11300 11300 11300 11300 11300 11300 11300 11300 11300 11300 11300 11300 11300 11300 11300 11300 11300 11300
                    11300 11300 11300 11300 11300 11300 11300 11300 11300 11300 11300 11300 11300 11300 11300 11300 11300 11300
                    11300 11300 11300 11300 11300 11300 11300 11300 11300 11300 11300 11300 11300 11300 11300 11300 11300 11300
                    11300 11300 11300 11300 11300 11300 11300 11300 11300 11300 11300 11300 11300 11300 11300 11300 11300 11300
                    11300 11300 11300 11300 11300 11300 11300 11300 11300 11300 11300 11300 11300 11300 11300 11300 11300 11300
                    11300 11300 11300 11300 11300 11300 11300 11300 11300 11300 11300 11300 11300 11300 11300 11300 11300 11300
                    11300 11300 11300 11300 11300 11300 11300 11300 11300 11300 11300 11300 11300 11300 11300 11300 11300 11300
                    11300 11300 11300 11300 11300 11300 11300 11300 11300 11300 11300 11300 11300 11300 11300 11300 11300 11300
                    11300 11300 11300 11300 11300 11300 11300 11300 11300 11300 11300 11300 11300 11300 11300 11300 11300 11300
                    11300 11300 11300 11300 11300 11300 11300 11300 11300 11300 11300 11300 11300 11300 11300 11300 11300 11300
                    11300 11300 11300 11300 11300 11300 11300 11300 11300 11300 11300 11300 11300 11300 11300 11300 11300 11300
                    11300 11300 11300 11300 11300 11300 11300 11300 11300 11300 11300 11300 11300 11300 11300 11300 11300 11300
                    11300 11300 11300 11300 11300 11300 11300 11300 11300 11300 11300 11300 11300 11300 11300 11300 11300 11300
                    11300 11300 11300 11300 11300 11300 11300 11300 11300 11300 11300 11300 11300 11300 11300 11300 11300 11300
                    11300 11300 11300 11300 11300 11300 11300 11300 11300 11300 11300 11300 11300 11300 11300 11300 11300 11300
                    11300 11300 11300 11300 11300 11300 11300 11300 11300 11300 11300 11300 11300 11300 11300 11300 11300 11300
                    11300 11300 11300 11300 11300 11300 11300 11300 11300 11300 11300 11300 11300 11300 11300 11300 11300 11300
                    11300 11300 11300 11300 11300 11300 11300 11300 11300 11300 11300 11300 11300 11300 11300 11300 11300 11300
                    11300 11300 11300 11300 11300 11300 11300 11300 11300 11300 11300 11300 11300 11300 11300 11300 11300 11300
                    11300 11300 11300 11300 11300 11300 11300 11300 11300 11300 11300 11300 11300 11300 11300 11300 11300 11300
                    11300 11300 11300 11300 11300 11300 11300 11300 11300 11300 11300 11300 11300 11300 11300 11300 11300 11300
                    11300 11300 11300 11300 11300 11300 11300 11300 11300 11300 11300 11300 11300 11300 11300 11300 11300 11300>;

                PS_Config_Lmt_Open_Rawdata_P = <
                    65535 3114 3121 3109 3146 3153 3173 3216 65535 65535 3351 3257 3301 3251 3139 3064 3021 65535
                    2857  2913 2930 2939 2915 2911 2911 2893 2852  2881  2913 2929 2933 2936 2886 2801 2753 2682
                    2847  2895 2915 2923 2905 2896 2886 2872 2837  2893  2922 2943 2953 2957 2908 2817 2774 2707
                    2851  2901 2926 2935 2919 2915 2903 2885 2847  2933  2970 2993 3004 3011 2956 2869 2825 2757
                    2888  2939 2970 2979 2953 2947 2945 2920 2881  2906  2942 2966 2969 2980 2936 2854 2811 2742
                    2855  2905 2939 2946 2929 2919 2912 2893 2848  3054  3097 3121 3132 3149 3098 3010 2969 2895
                    2959  3007 3072 3065 3057 3038 3034 3016 2980  3047  3091 3115 3122 3136 3094 3013 2943 2872
                    2940  2986 3051 3055 3034 3021 3017 2996 2963  3092  3135 3158 3172 3187 3153 3075 3010 2935
                    2967  3023 3082 3082 3061 3054 3044 3023 2984  3071  3116 3138 3146 3168 3133 3067 3001 2926
                    2994  3054 3105 3115 3094 3092 3064 3043 3008  3094  3143 3170 3185 3209 3180 3105 3037 2964
                    3061  3115 3169 3177 3165 3152 3135 3109 3072  3153  3199 3226 3246 3267 3239 3166 3097 3027
                    3122  3177 3229 3244 3229 3219 3195 3179 3136  3183  3223 3258 3273 3294 3275 3202 3138 3067
                    3094  3136 3190 3193 3195 3187 3172 3152 3111  3153  3204 3223 3250 3267 3253 3185 3125 3054
                    3124  3169 3216 3237 3224 3220 3202 3182 3148  3196  3247 3267 3291 3308 3307 3236 3179 3108
                    3173  3220 3273 3285 3277 3273 3253 3230 3195  3180  3230 3253 3275 3287 3291 3229 3176 3099
                    3169  3213 3267 3278 3263 3260 3246 3223 3183  3308  3361 3386 3410 3430 3436 3383 3319 3244
                    3339  3393 3430 3474 3464 3459 3442 3427 3383  3312  3371 3389 3416 3429 3452 3434 3389 3317
                    3268  3312 3345 3382 3375 3366 3352 3335 3300  3327  3388 3409 3434 3454 3480 3467 3417 3344
                    3408  3450 3490 3518 3518 3503 3496 3480 3437  3301  3356 3383 3408 3436 3459 3456 3402 3337
                    3358  3395 3425 3453 3459 3444 3439 3416 3382  3325  3378 3406 3440 3459 3486 3488 3433 3375
                    3420  3456 3484 3511 3520 3505 3520 3497 3467  3348  3403 3427 3432 3457 3480 3490 3449 3385
                    3373  3400 3427 3439 3454 3449 3456 3436 3403  3447  3500 3524 3531 3555 3575 3601 3557 3496
                    3548  3572 3596 3615 3629 3625 3623 3603 3578  3372  3425 3450 3459 3473 3498 3517 3490 3425
                    3425  3453 3477 3487 3508 3505 3505 3486 3457  3505  3561 3575 3581 3599 3621 3652 3621 3568
                    3520  3538 3565 3578 3595 3585 3584 3569 3547  3505  3557 3571 3576 3596 3615 3656 3623 3575
                    3503  3515 3547 3551 3574 3567 3562 3547 3527  3605  3653 3666 3677 3692 3716 3754 3734 3690
                    3557  3582 3608 3621 3636 3625 3605 3596 3576  3508  3547 3567 3589 3606 3625 3653 3645 3598
                    3605  3623 3636 3649 3667 3649 3632 3616 3595  3594  3645 3666 3693 3706 3738 3760 3760 3711
                    3616  3642 3645 3656 3670 3653 3636 3618 3602  3496  3532 3565 3588 3605 3632 3665 3657 3613
                    3632  3639 3645 3646 3656 3647 3628 3603 3591  3538  3579 3612 3630 3659 3682 3714 3714 3669
                    2929  3642 3647 3649 3650 3636 3623 3603 3588  3523  3562 3595 3621 3647 3667 3703 3704 2937
                    3038  3608 3690 3687 3683 3677 3655 3656 3666  3601  3619 3639 3660 3687 3706 3738 3666 3035>;

                PS_Config_Lmt_Open_Rawdata_N = <
                    (-65535) 1271 1274 1270 1285 1288 1296 1313 (-65535) (-65535) 1368 330 1348 1328 1282 1251 1234 (-65535)
                    1166 1190 1197 1200 1190 1189 1189 1182 1165 1176 1190 1196 1198 1199 1179 1144 1124 1095
                    1162 1182 1190 1194 1186 1183 1179 1173 1158 1182 1193 1202 1206 1208 1187 1150 1133 1106
                    1164 1184 1195 1198 1192 1190 1186 1178 1162 1198 1213 1222 1227 1230 1207 1172 1154 1126
                    1179 1200 1213 1216 1206 1204 1202 1193 1176 1187 1201 1211 1212 1217 1199 1165 1148 1119
                    1166 1186 1200 1203 1196 1192 1189 1182 1163 1247 1264 1274 1279 1286 1265 1229 1212 1182
                    1208 1228 1255 1252 1248 1241 1239 1231 1217 1244 1262 1272 1275 1281 1263 1230 1202 1173
                    1201 1219 1246 1248 1239 1234 1232 1223 1210 1263 1280 1289 1295 1302 1288 1256 1229 1198
                    1212 1234 1259 1259 1250 1247 1243 1234 1219 1254 1273 1281 1285 1293 1280 1252 1226 1195
                    1223 1247 1268 1272 1263 1263 1251 1242 1229 1263 1284 1295 1300 1310 1299 1268 1240 1211
                    1250 1272 1294 1298 1292 1287 1280 1270 1255 1288 1306 1317 1325 1334 1322 1293 1264 1236
                    1275 1298 1318 1325 1318 1314 1305 1298 1281 1300 1316 1331 1336 1345 1338 1307 1281 1252
                    1263 1281 1303 1304 1305 1302 1295 1287 1270 1288 1309 1316 1327 1334 1328 1300 1276 1247
                    1276 1294 1313 1322 1317 1315 1307 1299 1285 1305 1326 1334 1344 1351 1350 1321 1298 1269
                    1296 1315 1336 1342 1338 1336 1328 1319 1305 1299 1319 1328 1338 1342 1344 1318 1297 1266
                    1294 1312 1334 1339 1332 1331 1325 1316 1300 1351 1372 1383 1393 1401 1403 1382 1356 1325
                    1364 1386 1401 1419 1415 1412 1405 1400 1382 1353 1376 1384 1395 1400 1409 1403 1384 1354
                    1335 1353 1366 1381 1378 1375 1369 1362 1347 1358 1383 1392 1403 1411 1421 1416 1396 1365
                    1392 1409 1425 1437 1437 1430 1427 1421 1404 1348 1371 1382 1392 1403 1412 1411 1389 1363
                    1371 1386 1398 1410 1412 1407 1404 1395 1381 1358 1379 1391 1405 1412 1423 1425 1402 1378
                    1397 1411 1423 1434 1437 1432 1437 1428 1416 1367 1390 1400 1401 1412 1421 1425 1408 1382
                    1378 1389 1400 1404 1411 1408 1411 1403 1390 1408 1429 1439 1442 1452 1460 1470 1452 1427
                    1449 1459 1469 1476 1482 1480 1480 1472 1461 1377 1398 1409 1412 1418 1429 1436 1425 1398
                    1398 1410 1420 1424 1433 1432 1432 1423 1412 1432 1454 1460 1462 1470 1479 1491 1479 1457
                    1437 1445 1456 1461 1468 1464 1463 1458 1448 1432 1452 1458 1461 1469 1476 1493 1480 1460
                    1430 1436 1448 1450 1459 1456 1455 1448 1440 1472 1492 1497 1502 1508 1517 1533 1525 1507
                    1452 1463 1473 1479 1485 1480 1472 1469 1461 1433 1448 1456 1466 1473 1480 1492 1488 1469
                    1472 1480 1485 1490 1498 1490 1483 1477 1468 1467 1488 1497 1508 1513 1527 1535 1535 1516
                    1477 1487 1488 1493 1499 1492 1485 1477 1471 1427 1443 1456 1465 1472 1483 1496 1494 1476
                    1483 1486 1488 1489 1493 1490 1481 1472 1466 1445 1462 1475 1483 1494 1503 1517 1517 1498
                    1196 1487 1490 1490 1491 1485 1480 1472 1465 1438 1455 1468 1479 1490 1498 1512 1513 1200
                    1241 1473 1507 1506 1504 1502 1492 1493 1497 1470 1478 1486 1495 1506 1513 1527 1497 1240>;

                PS_Config_Lmt_FW_Rawdata_P = <
                    65535 2218 2182 2164 2155 2141 2338 2316 5535 65535 2442 2395 2317 2219 2154 2325 2343 65535
                    2257 2114 2098 2090 2324 2280 2276 2256 2250 2196 2166 2127 2301 2243 2385 2297 2249 2304
                    2367 2223 2210 2440 2412 2395 2375 2358 2338 2416 2408 2364 2317 2256 2164 2103 2311 2374
                    2138 2291 2294 2277 2256 2226 2203 2166 2144 2311 2306 2266 2212 2394 2316 2259 2230 2334
                    2247 2345 2341 2330 2298 2267 2250 2216 2203 2108 2333 2287 2237 2412 2341 2272 2260 2145
                    2318 2226 2229 2240 2186 2147 2130 2341 2323 2218 2425 2396 2334 2267 2212 2121 2098 2421
                    2253 2134 2110 2120 2306 2284 2277 2252 2239 2408 2395 2368 2306 2242 2191 2324 2272 2345
                    2117 2259 2264 2267 2226 2201 2172 2128 2112 2350 2330 2294 2236 2175 2137 2273 2233 2345
                    2423 2338 2343 2308 2289 2270 2247 2459 2449 2152 2139 2110 2294 2219 2387 2321 2289 2134
                    2250 2381 2388 2348 2345 2318 2296 2269 2246 2433 2411 2372 2318 2247 2166 2128 2341 2412
                    2199 2335 2364 2334 2320 2294 2257 2226 2199 2202 2433 2409 2365 2300 2206 2125 2320 2358
                    2174 2310 2327 2294 2287 2250 2222 2188 2165 2135 2120 2327 2290 2226 2382 2298 2259 2324
                    2210 2286 2274 2263 2242 2438 2408 2384 2368 2230 2445 2408 2365 2290 2220 2152 2340 2422
                    2284 2199 2196 2182 2158 2130 2338 2304 2280 2311 2304 2259 2208 2145 2324 2247 2422 2245
                    2103 2191 2202 2199 2175 2141 2114 2320 2293 2259 2250 2208 2154 2320 2270 2435 2412 2253
                    2259 2154 2147 2174 2149 2120 2328 2281 2240 2254 2243 2422 2377 2298 2240 2164 2130 2259
                    2223 2317 2287 2320 2297 2263 2227 2201 2172 2125 2141 2103 2308 2245 2203 2364 2304 2144
                    2433 2306 2310 2341 2311 2294 2253 2448 2415 2185 2171 2118 2317 2240 2195 2362 2348 2193
                    2331 2192 2193 2218 2202 2169 2137 2100 2316 2182 2165 2138 2325 2253 2418 2360 2335 2193
                    2203 2333 2345 2352 2350 2321 2283 2250 2226 2139 2125 2325 2279 2202 2382 2328 2291 2182
                    2245 2280 2311 2307 2290 2269 2240 2209 2176 2396 2398 2361 2293 2239 2179 2137 2297 2440
                    2212 2318 2340 2335 2323 2291 2270 2233 2210 2298 2266 2226 2166 2321 2254 2205 2404 2388
                    2122 2223 2250 2245 2233 2199 2185 2149 2110 2438 2415 2375 2311 2254 2196 2168 2338 2455
                    2233 2320 2318 2328 2324 2298 2267 2232 2218 2296 2242 2208 2382 2307 2257 2205 2156 2301
                    2276 2091 2323 2318 2307 2264 2247 2205 2448 2148 2323 2277 2222 2369 2320 2304 2269 2159
                    2338 2414 2408 2401 2394 2361 2337 2307 2343 2318 2239 2405 2345 2273 2206 2166 2131 2304
                    2210 2266 2262 2269 2270 2236 2206 2185 2247 2135 2253 2212 2398 2323 2259 2222 2205 2328
                    2316 2131 2122 2110 2108 2308 2298 2272 2112 2281 2131 2333 2267 2423 2345 2303 2286 2235
                    2388 2219 2210 2198 2435 2399 2382 2350 2445 2226 2321 2280 2213 2138 2323 2290 2260 2418
                    2350 2384 2377 2372 2361 2328 2317 2290 2394 2195 2290 2242 2409 2333 2266 2213 2209 2178
                    2229 2199 2189 2445 2433 2395 2384 2352 2243 2267 2340 2300 2236 2401 2350 2308 2294 2210
                    2320 2406 2371 2343 2355 2338 2331 2298 2279 2358 2131 2310 2254 2384 2314 2281 2284 2199>;

                PS_Config_Lmt_FW_Rawdata_N = <
                    (-65535) 905 891 883 880 874 955 945 (-65535) (-65535) 997 978 946 906 879 950 957 (-65535)
                    922 863 857 853 949 931 929 921  919  897 885 868 940 916 974 938 918 941
                    966 908 903 997 985 978 970 963  955  987 983 965 946 921 883 858 944 969
                    873 936 937 930 921 909 900 885  875  944 941 925 903 977 945 922 911 953
                    918 958 956 951 939 926 919 905  900  861 952 934 914 985 956 928 923 876
                    947 909 910 915 893 876 870 956  948  905 990 979 953 926 903 866 857 988
                    920 871 861 865 941 933 930 919  914  983 978 967 941 915 894 949 928 958
                    864 922 925 926 909 899 887 869  863  959 951 937 913 888 872 928 912 958
                    990 955 957 943 934 927 918 1004 1000 879 874 861 937 906 974 948 934 871
                    919 972 975 959 958 947 937 926  917  994 984 969 947 918 885 869 956 985
                    898 954 965 953 947 937 922 909  898  899 994 984 966 939 901 868 947 963
                    887 943 950 937 934 919 907 893  884  872 865 950 935 909 973 939 922 949
                    903 933 929 924 915 995 983 973  967  911 998 983 966 935 907 879 955 989
                    933 898 897 891 881 870 955 941  931  944 941 922 901 876 949 918 989 916
                    858 894 899 898 888 874 863 947  936  922 919 901 879 947 927 994 985 920
                    922 879 876 887 878 865 951 932  915  921 916 989 970 939 915 883 870 922
                    908 946 934 947 938 924 910 899  887  868 874 858 943 916 900 965 941 875
                    994 941 943 956 944 937 920 999  986  892 886 865 946 915 896 965 959 896
                    952 895 896 905 899 886 872 857  945  891 884 873 950 920 987 963 954 896
                    900 952 958 961 959 948 932 919  909  874 868 950 930 899 973 951 936 891
                    916 931 944 942 935 926 915 902  889  979 979 964 936 914 890 872 938 997
                    903 947 955 954 948 936 927 912  903  939 925 909 885 948 921 900 981 975
                    867 908 919 916 912 898 892 878  861  995 986 970 944 921 897 885 955 1002
                    912 947 947 951 949 939 926 911  905  937 915 901 973 942 922 900 881 940
                    929 854 948 947 942 925 918 900  999  877 948 930 907 968 947 941 926 882
                    955 986 983 980 977 964 954 942  957  947 914 982 958 928 901 885 870 941
                    903 925 923 926 927 913 901 892  918  872 920 903 979 948 922 907 900 951
                    945 870 867 861 861 943 939 928  863  932 870 952 926 990 958 940 933 912
                    975 906 903 897 994 980 973 959  998  909 948 931 904 873 948 935 923 987
                    959 973 970 969 964 951 946 935  977  896 935 915 984 952 925 904 902 889
                    910 898 894 998 994 978 973 961  916  926 955 939 913 980 959 943 937 903
                    947 983 968 957 962 955 952 939  930  963 870 943 921 973 945 932 933 898>;

                PS_Config_Lmt_FW_CC_P = <
                    65535 71 71 71 71 71 70	70 65535 65535 74 74 74 74 74 72 72 65535
                    72 74 74 74 72 72 72 72	72 82 82 82 81 81 79 79 79 78
                    68 70 70 68 68 68 68 68	68 74 74 74 74 74 74 74 72 71
                    77 77 77 77 77 77 77 77	77 75 75 75 75 74 74 74 74 72
                    68 68 68 68 68 68 68 68	68 74 72 72 72 71 71 71 71 71
                    75 77 77 77 77 77 77 75	75 78 77 77 77 77 77 77 77 74
                    67 68 68 68 67 67 67 67	67 77 77 77 77 77 77 75 75 74
                    74 74 74 74 74 74 74 74	74 77 77 77 77 77 77 75 75 74
                    68 70 70 70 70 70 70 68	68 77 77 77 75 75 74 74 74 74
                    71 71 71 71 71 71 71 71	71 74 74 74 74 74 74 74 72 71
                    74 74 74 74 74 74 74 74	74 81 79 79 79 79 79 79 78 77
                    74 74 74 74 74 74 74 74	74 82 82 81 81 81 79 79 79 78
                    67 67 67 67 67 65 65 65	65 78 77 77 77 77 77 77 75 74
                    72 74 74 74 74 74 72 72	72 79 79 79 79 79 78 78 77 77
                    74 74 74 74 74 74 74 72	72 74 74 74 74 72 72 71 71 71
                    75 77 77 77 77 77 75 75	75 78 78 77 77 77 77 77 77 75
                    71 71 71 71 71 71 71 71	71 82 82 82 81 81 81 79 79 79
                    71 72 72 72 72 72 72 71	71 77 77 77 75 75 75 74 74 74
                    72 74 74 74 74 74 74 74	72 74 74 74 72 72 71 71 71 71
                    74 74 74 74 74 74 74 74	74 77 77 75 75 75 74 74 74 74
                    71 71 71 71 71 71 71 71	71 77 77 77 77 77 77 77 75 74
                    71 71 71 71 71 71 71 71	71 71 71 71 71 70 70 70 68 68
                    77 77 77 77 77 77 77 77	77 77 77 77 77 77 77 77 75 74
                    71 71 71 71 71 71 71 71	71 75 75 75 74 74 74 74 74 72
                    67 68 67 67 67 67 67 67	65 77 75 75 75 74 74 74 74 74
                    68 68 68 68 68 68 68 68	68 78 78 77 77 77 77 77 77 75
                    74 74 74 74 74 74 74 74	74 77 75 75 74 74 74 74 74 72
                    70 71 71 71 71 70 70 70	71 71 71 70 70 68 68 68 68 68
                    74 75 75 75 74 74 74 74	74 75 74 74 74 74 72 72 72 71
                    68 68 68 68 68 68 68 68	68 74 72 72 71 71 71 71 71 71
                    75 75 75 74 74 74 74 74	75 77 75 75 75 74 74 74 74 74
                    77 77 77 77 77 77 77 77	78 79 79 78 78 77 77 77 77 77>;

                PS_Config_Lmt_FW_CC_N = <
                    (-65535) 30 30 30 30 30 30 30 (-65535) (-65535) 31 31 31 31 31 31 31 (-65535)
                    31 31 31 31 31 31 31 31 31 35 35 35 34 34 34 34 34 33
                    29 30 30 29 29 29 29 29 29 31 31 31 31 31 31 31 31 30
                    33 33 33 33 33 33 33 33 33 32 32 32 32 31 31 31 31 31
                    29 29 29 29 29 29 29 29 29 31 31 31 31 30 30 30 30 30
                    32 33 33 33 33 33 33 32 32 33 33 33 33 33 33 33 33 31
                    28 29 29 29 28 28 28 28 28 33 33 33 33 33 33 32 32 31
                    31 31 31 31 31 31 31 31 31 33 33 33 33 33 33 32 32 31
                    29 30 30 30 30 30 30 29 29 33 33 33 32 32 31 31 31 31
                    30 30 30 30 30 30 30 30 30 31 31 31 31 31 31 31 31 30
                    31 31 31 31 31 31 31 31 31 34 34 34 34 34 34 34 33 33
                    31 31 31 31 31 31 31 31 31 35 35 34 34 34 34 34 34 33
                    28 28 28 28 28 28 28 28 28 33 33 33 33 33 33 33 32 31
                    31 31 31 31 31 31 31 31 31 34 34 34 34 34 33 33 33 33
                    31 31 31 31 31 31 31 31 31 31 31 31 31 31 31 30 30 30
                    32 33 33 33 33 33 32 32 32 33 33 33 33 33 33 33 33 32
                    30 30 30 30 30 30 30 30 30 35 35 35 34 34 34 34 34 34
                    30 31 31 31 31 31 31 30 30 33 33 33 32 32 32 31 31 31
                    31 31 31 31 31 31 31 31 31 31 31 31 31 31 30 30 30 30
                    31 31 31 31 31 31 31 31 31 33 33 32 32 32 31 31 31 31
                    30 30 30 30 30 30 30 30 30 33 33 33 33 33 33 33 32 31
                    30 30 30 30 30 30 30 30 30 30 30 30 30 30 30 30 29 29
                    33 33 33 33 33 33 33 33 33 33 33 33 33 33 33 33 32 31
                    30 30 30 30 30 30 30 30 30 32 32 32 31 31 31 31 31 31
                    28 29 28 28 28 28 28 28 28 33 32 32 32 31 31 31 31 31
                    29 29 29 29 29 29 29 29 29 33 33 33 33 33 33 33 33 32
                    31 31 31 31 31 31 31 31 31 33 32 32 31 31 31 31 31 31
                    30 30 30 30 30 30 30 30 30 30 30 30 30 29 29 29 29 29
                    31 32 32 32 31 31 31 31 31 32 31 31 31 31 31 31 31 30
                    29 29 29 29 29 29 29 29 29 31 31 31 30 30 30 30 30 30
                    32 32 32 31 31 31 31 31 32 33 32 32 32 31 31 31 31 31
                    33 33 33 33 33 33 33 33 33 34 34 33 33 33 33 33	33 33>;

                PS_Config_Lmt_FW_Diff_P = <
                    65535 60 60 60 60 60 60 60 65535 65535 60 60 60 60 60 60 60 65535
                    60 60 60 60 60 60 60 60 60 60 60 60 60 60 60 60 60 60
                    60 60 60 60 60 60 60 60 60 60 60 60 60 60 60 60 60 60
                    60 60 60 60 60 60 60 60 60 60 60 60 60 60 60 60 60 60
                    60 60 60 60 60 60 60 60 60 60 60 60 60 60 60 60 60 60
                    60 60 60 60 60 60 60 60 60 60 60 60 60 60 60 60 60 60
                    60 60 60 60 60 60 60 60 60 60 60 60 60 60 60 60 60 60
                    60 60 60 60 60 60 60 60 60 60 60 60 60 60 60 60 60 60
                    60 60 60 60 60 60 60 60 60 60 60 60 60 60 60 60 60 60
                    60 60 60 60 60 60 60 60 60 60 60 60 60 60 60 60 60 60
                    60 60 60 60 60 60 60 60 60 60 60 60 60 60 60 60 60 60
                    60 60 60 60 60 60 60 60 60 60 60 60 60 60 60 60 60 60
                    60 60 60 60 60 60 60 60 60 60 60 60 60 60 60 60 60 60
                    60 60 60 60 60 60 60 60 60 60 60 60 60 60 60 60 60 60
                    60 60 60 60 60 60 60 60 60 60 60 60 60 60 60 60 60 60
                    60 60 60 60 60 60 60 60 60 60 60 60 60 60 60 60 60 60
                    60 60 60 60 60 60 60 60 60 60 60 60 60 60 60 60 60 60
                    60 60 60 60 60 60 60 60 60 60 60 60 60 60 60 60 60 60
                    60 60 60 60 60 60 60 60 60 60 60 60 60 60 60 60 60 60
                    60 60 60 60 60 60 60 60 60 60 60 60 60 60 60 60 60 60
                    60 60 60 60 60 60 60 60 60 60 60 60 60 60 60 60 60 60
                    60 60 60 60 60 60 60 60 60 60 60 60 60 60 60 60 60 60
                    60 60 60 60 60 60 60 60 60 60 60 60 60 60 60 60 60 60
                    60 60 60 60 60 60 60 60 60 60 60 60 60 60 60 60 60 60
                    60 60 60 60 60 60 60 60 60 60 60 60 60 60 60 60 60 60
                    60 60 60 60 60 60 60 60 60 60 60 60 60 60 60 60 60 60
                    60 60 60 60 60 60 60 60 60 60 60 60 60 60 60 60 60 60
                    60 60 60 60 60 60 60 60 60 60 60 60 60 60 60 60 60 60
                    60 60 60 60 60 60 60 60 60 60 60 60 60 60 60 60 60 60
                    60 60 60 60 60 60 60 60 60 60 60 60 60 60 60 60 60 60
                    60 60 60 60 60 60 60 60 60 60 60 60 60 60 60 60 60 60
                    60 60 60 60 60 60 60 60 60 60 60 60 60 60 60 60 60 60>;

                PS_Config_Lmt_FW_Diff_N = <
                    (-65535) (-60) (-60) (-60) (-60) (-60) (-60) (-60) (-65535) (-65535) (-60) (-60) (-60) (-60) (-60) (-60) (-60) (-65535)
                    (-60) (-60) (-60) (-60)	(-60) (-60)	(-60) (-60)	(-60) (-60) (-60) (-60) (-60) (-60) (-60) (-60) (-60) (-60)
                    (-60) (-60) (-60) (-60)	(-60) (-60)	(-60) (-60)	(-60) (-60) (-60) (-60) (-60) (-60) (-60) (-60) (-60) (-60)
                    (-60) (-60) (-60) (-60)	(-60) (-60)	(-60) (-60)	(-60) (-60) (-60) (-60) (-60) (-60) (-60) (-60) (-60) (-60)
                    (-60) (-60) (-60) (-60)	(-60) (-60)	(-60) (-60)	(-60) (-60) (-60) (-60) (-60) (-60) (-60) (-60) (-60) (-60)
                    (-60) (-60) (-60) (-60)	(-60) (-60)	(-60) (-60)	(-60) (-60) (-60) (-60) (-60) (-60) (-60) (-60) (-60) (-60)
                    (-60) (-60) (-60) (-60)	(-60) (-60)	(-60) (-60)	(-60) (-60) (-60) (-60) (-60) (-60) (-60) (-60) (-60) (-60)
                    (-60) (-60) (-60) (-60)	(-60) (-60)	(-60) (-60)	(-60) (-60) (-60) (-60) (-60) (-60) (-60) (-60) (-60) (-60)
                    (-60) (-60) (-60) (-60)	(-60) (-60)	(-60) (-60)	(-60) (-60) (-60) (-60) (-60) (-60) (-60) (-60) (-60) (-60)
                    (-60) (-60) (-60) (-60)	(-60) (-60)	(-60) (-60)	(-60) (-60) (-60) (-60) (-60) (-60) (-60) (-60) (-60) (-60)
                    (-60) (-60) (-60) (-60)	(-60) (-60)	(-60) (-60)	(-60) (-60) (-60) (-60) (-60) (-60) (-60) (-60) (-60) (-60)
                    (-60) (-60) (-60) (-60)	(-60) (-60)	(-60) (-60)	(-60) (-60) (-60) (-60) (-60) (-60) (-60) (-60) (-60) (-60)
                    (-60) (-60) (-60) (-60)	(-60) (-60)	(-60) (-60)	(-60) (-60) (-60) (-60) (-60) (-60) (-60) (-60) (-60) (-60)
                    (-60) (-60) (-60) (-60)	(-60) (-60)	(-60) (-60)	(-60) (-60) (-60) (-60) (-60) (-60) (-60) (-60) (-60) (-60)
                    (-60) (-60) (-60) (-60)	(-60) (-60)	(-60) (-60)	(-60) (-60) (-60) (-60) (-60) (-60) (-60) (-60) (-60) (-60)
                    (-60) (-60) (-60) (-60)	(-60) (-60)	(-60) (-60)	(-60) (-60) (-60) (-60) (-60) (-60) (-60) (-60) (-60) (-60)
                    (-60) (-60) (-60) (-60)	(-60) (-60)	(-60) (-60)	(-60) (-60) (-60) (-60) (-60) (-60) (-60) (-60) (-60) (-60)
                    (-60) (-60) (-60) (-60)	(-60) (-60)	(-60) (-60)	(-60) (-60) (-60) (-60) (-60) (-60) (-60) (-60) (-60) (-60)
                    (-60) (-60) (-60) (-60)	(-60) (-60)	(-60) (-60)	(-60) (-60) (-60) (-60) (-60) (-60) (-60) (-60) (-60) (-60)
                    (-60) (-60) (-60) (-60)	(-60) (-60)	(-60) (-60)	(-60) (-60) (-60) (-60) (-60) (-60) (-60) (-60) (-60) (-60)
                    (-60) (-60) (-60) (-60)	(-60) (-60)	(-60) (-60)	(-60) (-60) (-60) (-60) (-60) (-60) (-60) (-60) (-60) (-60)
                    (-60) (-60) (-60) (-60)	(-60) (-60)	(-60) (-60)	(-60) (-60) (-60) (-60) (-60) (-60) (-60) (-60) (-60) (-60)
                    (-60) (-60) (-60) (-60)	(-60) (-60)	(-60) (-60)	(-60) (-60) (-60) (-60) (-60) (-60) (-60) (-60) (-60) (-60)
                    (-60) (-60) (-60) (-60)	(-60) (-60)	(-60) (-60)	(-60) (-60) (-60) (-60) (-60) (-60) (-60) (-60) (-60) (-60)
                    (-60) (-60) (-60) (-60)	(-60) (-60)	(-60) (-60)	(-60) (-60) (-60) (-60) (-60) (-60) (-60) (-60) (-60) (-60)
                    (-60) (-60) (-60) (-60)	(-60) (-60)	(-60) (-60)	(-60) (-60) (-60) (-60) (-60) (-60) (-60) (-60) (-60) (-60)
                    (-60) (-60) (-60) (-60)	(-60) (-60)	(-60) (-60)	(-60) (-60) (-60) (-60) (-60) (-60) (-60) (-60) (-60) (-60)
                    (-60) (-60) (-60) (-60)	(-60) (-60)	(-60) (-60)	(-60) (-60) (-60) (-60) (-60) (-60) (-60) (-60) (-60) (-60)
                    (-60) (-60) (-60) (-60)	(-60) (-60)	(-60) (-60)	(-60) (-60) (-60) (-60) (-60) (-60) (-60) (-60) (-60) (-60)
                    (-60) (-60) (-60) (-60)	(-60) (-60)	(-60) (-60)	(-60) (-60) (-60) (-60) (-60) (-60) (-60) (-60) (-60) (-60)
                    (-60) (-60) (-60) (-60)	(-60) (-60)	(-60) (-60)	(-60) (-60) (-60) (-60) (-60) (-60) (-60) (-60) (-60) (-60)
                    (-60) (-60) (-60) (-60)	(-60) (-60)	(-60) (-60)	(-60) (-60) (-60) (-60) (-60) (-60) (-60) (-60) (-60) (-60)>;

                PS_Config_Diff_Test_Frame = <50>;
        };
    };
};
