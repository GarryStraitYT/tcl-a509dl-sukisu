/*
 * Copyright (C) 2010 - 2018 Novatek, Inc.
 *
 * $Revision: 52935 $
 * $Date: 2019-11-11 10:24:25 +0800 (Mon, 11 Nov 2019) $
 *
 * This program is free software; you can redistribute it and/or modify
 * it under the terms of the GNU General Public License as published by
 * the Free Software Foundation; either version 2 of the License, or
 * (at your option) any later version.
 *
 * This program is distributed in the hope that it will be useful, but WITHOUT
 * ANY WARRANTY; without even the implied warranty of MERCHANTABILITY or
 * FITNESS FOR A PARTICULAR PURPOSE.  See the GNU General Public License for
 * more details.
 *
 */

&spi0 {
        #address-cells = <1>;
        #size-cells = <0>;
        status = "okay";
        tct,touch@0 {
            status = "okay";
            compatible = "tct,touch";
            reg = <0x0>;
            interrupt-parent = <&pio>;
            interrupts = <0 IRQ_TYPE_EDGE_FALLING 0 0>;
            //focal
            focaltech,reset-gpio = <&pio 11 0x0>;
            focaltech,irq-gpio = <&pio 0 0x0>;
/* Begin jingqing.yan power LCD bias gpio on 20210901 */
            focaltech,bias-neg-gpio = <&pio 171 0x00>;
            focaltech,bias-pos-gpio = <&pio 173 0x00>;
/* End jingqing.yan power LCD bias gpio on 20210901 */
            focaltech,max-touch-number = <5>;
            focaltech,display-coords =  <0 0 720 1600>;
            spi-max-frequency = <5000000>;
			/*Begind For ICNL9911C*/
			chipone,rst-gpio = <&pio 11 0x00>;
			chipone,irq-gpio = <&pio 0 0x00>;
			chipone,x-res = <720>;
			chipone,y-res = <1600>;
			/*End For ICNL9911C*/

            //novatek
            //spi-max-frequency = <9600000>;	//4800000,9600000,15000000,19200000
            novatek,reset-gpio = <&pio 11 0x0>;
            novatek,irq-gpio = <&pio 0 0x0>;
            /* 525 */
            //novatek,swrst-n8-addr = <0x01F01A>;
            /* 672A, 525B, 675, 526, 672C */
            novatek,swrst-n8-addr = <0x03F0FE>;
            novatek,spi-rd-fast-addr = <0x03F310>;
    };
};
